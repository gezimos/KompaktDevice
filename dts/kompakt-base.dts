/dts-v1/;

/ {
	model = "MT6761";
	compatible = "mediatek,MT6761";
	interrupt-parent = <0x01>;
	#address-cells = <0x02>;
	#size-cells = <0x02>;

	chosen {
		bootargs = "console=tty0 console=ttyS0,921600n1 vmalloc=400M slub_debug=OFZPU page_owner=on swiotlb=noforce cgroup.memory=nosocket,nokmem androidboot.hardware=mt6761 maxcpus=8 loop.max_part=7 firmware_class.path=/vendor/firmware";
		kaslr-seed = <0x00 0x00>;
		phandle = <0x28>;
	};

	opp_table0 {
		compatible = "operating-points-v2";
		opp-shared;
		phandle = <0x02>;

		opp0 {
			opp-hz = <0x00 0x32a9f880>;
			opp-microvolt = <0x9eb10>;
		};

		opp1 {
			opp-hz = <0x00 0x36b79180>;
			opp-microvolt = <0xa344e>;
		};

		opp2 {
			opp-hz = <0x00 0x3ad46cc0>;
			opp-microvolt = <0xa7d8c>;
		};

		opp3 {
			opp-hz = <0x00 0x3ef14800>;
			opp-microvolt = <0xac6ca>;
		};

		opp4 {
			opp-hz = <0x00 0x430e2340>;
			opp-microvolt = <0xb1008>;
		};

		opp5 {
			opp-hz = <0x00 0x487ab000>;
			opp-microvolt = <0xb71b0>;
		};

		opp6 {
			opp-hz = <0x00 0x4df67f00>;
			opp-microvolt = <0xbd358>;
		};

		opp7 {
			opp-hz = <0x00 0x53724e00>;
			opp-microvolt = <0xc3500>;
		};

		opp8 {
			opp-hz = <0x00 0x57616280>;
			opp-microvolt = <0xc96a8>;
		};

		opp9 {
			opp-hz = <0x00 0x5b5fb940>;
			opp-microvolt = <0xcf850>;
		};

		opp10 {
			opp-hz = <0x00 0x61559a40>;
			opp-microvolt = <0xd8acc>;
		};

		opp11 {
			opp-hz = <0x00 0x6553f100>;
			opp-microvolt = <0xdec74>;
		};

		opp12 {
			opp-hz = <0x00 0x695247c0>;
			opp-microvolt = <0xe4e1c>;
		};

		opp13 {
			opp-hz = <0x00 0x6d509e80>;
			opp-microvolt = <0xeafc4>;
		};

		opp14 {
			opp-hz = <0x00 0x72431940>;
			opp-microvolt = <0xf29d6>;
		};

		opp15 {
			opp-hz = <0x00 0x7744d640>;
			opp-microvolt = <0xfa3e8>;
		};
	};

	cpus {
		#address-cells = <0x01>;
		#size-cells = <0x00>;

		cpu@000 {
			device_type = "cpu";
			compatible = "arm,cortex-a53";
			reg = <0x00>;
			enable-method = "psci";
			clock-frequency = <0x8b799100>;
			operating-points-v2 = <0x02>;
			dynamic-power-coefficient = <0x113>;
			capacity-dmips-mhz = <0x400>;
			cpu-idle-states = <0x03 0x04 0x05 0x06 0x07 0x08 0x09>;
			phandle = <0x0a>;
		};

		cpu@001 {
			device_type = "cpu";
			compatible = "arm,cortex-a53";
			reg = <0x01>;
			enable-method = "psci";
			clock-frequency = <0x8b799100>;
			operating-points-v2 = <0x02>;
			dynamic-power-coefficient = <0x113>;
			capacity-dmips-mhz = <0x400>;
			cpu-idle-states = <0x03 0x04 0x05 0x06 0x07 0x08 0x09>;
			phandle = <0x0b>;
		};

		cpu@002 {
			device_type = "cpu";
			compatible = "arm,cortex-a53";
			reg = <0x02>;
			enable-method = "psci";
			clock-frequency = <0x8b799100>;
			operating-points-v2 = <0x02>;
			dynamic-power-coefficient = <0x113>;
			capacity-dmips-mhz = <0x400>;
			cpu-idle-states = <0x03 0x04 0x05 0x06 0x07 0x08 0x09>;
			phandle = <0x0c>;
		};

		cpu@003 {
			device_type = "cpu";
			compatible = "arm,cortex-a53";
			reg = <0x03>;
			enable-method = "psci";
			clock-frequency = <0x8b799100>;
			operating-points-v2 = <0x02>;
			dynamic-power-coefficient = <0x113>;
			capacity-dmips-mhz = <0x400>;
			cpu-idle-states = <0x03 0x04 0x05 0x06 0x07 0x08 0x09>;
			phandle = <0x0d>;
		};

		cpu-map {

			cluster0 {

				core0 {
					cpu = <0x0a>;
				};

				core1 {
					cpu = <0x0b>;
				};

				core2 {
					cpu = <0x0c>;
				};

				core3 {
					cpu = <0x0d>;
				};
			};
		};

		idle-states {
			entry-method = "arm,psci";

			standby {
				compatible = "arm,idle-state";
				arm,psci-suspend-param = <0x01>;
				entry-latency-us = <0x258>;
				exit-latency-us = <0x258>;
				min-residency-us = <0x4b0>;
				phandle = <0x03>;
			};

			mcdi-cpu {
				compatible = "arm,idle-state";
				arm,psci-suspend-param = <0x10001>;
				entry-latency-us = <0x258>;
				exit-latency-us = <0x258>;
				min-residency-us = <0x4b0>;
				phandle = <0x04>;
			};

			mcdi-cluster {
				compatible = "arm,idle-state";
				arm,psci-suspend-param = <0x1010001>;
				entry-latency-us = <0x258>;
				exit-latency-us = <0x258>;
				min-residency-us = <0x4b0>;
				phandle = <0x05>;
			};

			sodi {
				compatible = "arm,idle-state";
				arm,psci-suspend-param = <0x1010002>;
				entry-latency-us = <0x320>;
				exit-latency-us = <0x3e8>;
				min-residency-us = <0x7d0>;
				phandle = <0x06>;
			};

			sodi3 {
				compatible = "arm,idle-state";
				arm,psci-suspend-param = <0x1010003>;
				entry-latency-us = <0x320>;
				exit-latency-us = <0x3e8>;
				min-residency-us = <0x7d0>;
				phandle = <0x07>;
			};

			dpidle {
				compatible = "arm,idle-state";
				arm,psci-suspend-param = <0x1010004>;
				entry-latency-us = <0x320>;
				exit-latency-us = <0x3e8>;
				min-residency-us = <0x7d0>;
				phandle = <0x08>;
			};

			suspend {
				compatible = "arm,idle-state";
				arm,psci-suspend-param = <0x1010005>;
				entry-latency-us = <0x320>;
				exit-latency-us = <0x3e8>;
				min-residency-us = <0x7d0>;
				phandle = <0x09>;
			};
		};
	};

	psci {
		compatible = "arm,psci-1.0";
		method = "smc";
	};

	pmu {
		compatible = "arm,armv8-pmuv3";
		interrupt-parent = <0x0e>;
		interrupts = <0x01 0x07 0x08>;
	};

	l2c_parity {
		compatible = "mediatek,l2c_parity-v1";
		interrupts = <0x00 0x00 0x04>;
	};

	memory {
		device_type = "memory";
		reg = <0x00 0x40000000 0x00 0x20000000>;
	};

	reserved-memory {
		#address-cells = <0x02>;
		#size-cells = <0x02>;
		ranges;
		phandle = <0x68>;

		reserve-memory-sspm_share {
			compatible = "mediatek,reserve-memory-sspm_share";
			no-map;
			status = "okay";
			size = <0x00 0x510000>;
			alignment = <0x00 0x10000>;
			alloc-ranges = <0x00 0x40000000 0x00 0x60000000>;
		};

		reserve-memory-scp_share {
			compatible = "mediatek,reserve-memory-scp_share";
			no-map;
			size = <0x00 0x300000>;
			alignment = <0x00 0x1000000>;
			alloc-ranges = <0x00 0x40000000 0x00 0x50000000>;
		};

		consys-reserve-memory {
			compatible = "mediatek,consys-reserve-memory";
			no-map;
			size = <0x00 0x400000>;
			alignment = <0x00 0x1000000>;
			alloc-ranges = <0x00 0x40000000 0x00 0x80000000>;
			phandle = <0x4a>;
		};

		wifi-reserve-memory {
			compatible = "shared-dma-pool";
			no-map;
			size = <0x00 0x300000>;
			alignment = <0x00 0x1000000>;
			alloc-ranges = <0x00 0x40000000 0x00 0x80000000>;
			phandle = <0x4b>;
		};

		ssmr-reserved-cma_memory {
			compatible = "shared-dma-pool";
			reusable;
			size = <0x00 0x10000000>;
			alignment = <0x00 0x1000000>;
			alloc-range = <0x00 0xc0000000 0x00 0x10000000>;
			phandle = <0x65>;
		};
	};

	utos {
		compatible = "microtrust,utos";
		interrupts = <0x00 0xbc 0x01 0x00 0xbd 0x01>;
	};

	utos_tester {
		compatible = "microtrust,tester-v1";
	};

	cpu_dbgapb@0d410000 {
		compatible = "mediatek,hw_dbg";
		num = <0x08>;
		reg = <0x00 0xd410000 0x00 0x1000 0x00 0xd510000 0x00 0x1000 0x00 0xd610000 0x00 0x1000 0x00 0xd710000 0x00 0x1000 0x00 0xd810000 0x00 0x1000 0x00 0xd910000 0x00 0x1000 0x00 0xda10000 0x00 0x1000 0x00 0xdb10000 0x00 0x1000>;
		phandle = <0x69>;
	};

	atf_logger {
		compatible = "mediatek,atf_logger";
		interrupts = <0x00 0x4e 0x01>;
	};

	amms_control {
		compatible = "mediatek,amms";
		interrupts = <0x00 0x43 0x01>;
	};

	interrupt-controller@0c000000 {
		compatible = "arm,gic-v3";
		#interrupt-cells = <0x03>;
		#address-cells = <0x02>;
		#size-cells = <0x02>;
		#redistributor-regions = <0x01>;
		interrupt-parent = <0x0e>;
		interrupt-controller;
		reg = <0x00 0xc000000 0x00 0x40000 0x00 0xc080000 0x00 0x200000 0x00 0x10200a80 0x00 0x50>;
		interrupts = <0x01 0x09 0x04>;
		phandle = <0x0e>;
	};

	intpol-controller@10200a80 {
		compatible = "mediatek,mt6577-sysirq";
		interrupt-controller;
		#interrupt-cells = <0x03>;
		interrupt-parent = <0x0e>;
		reg = <0x00 0x10200a80 0x00 0x50>;
		phandle = <0x01>;
	};

	infracfg_ao@10001000 {
		compatible = "mediatek,common-infracfg_ao\0mediatek,infracfg_ao\0mediatek,mt6761-infracfg\0syscon";
		reg = <0x00 0x10001000 0x00 0x1000>;
		interrupts = <0x00 0x5b 0x01>;
		#clock-cells = <0x01>;
		phandle = <0x22>;
	};

	mcdi@00110100 {
		compatible = "mediatek,mt6761-mcdi";
		reg = <0x00 0x110100 0x00 0x800>;
	};

	scpsys@10001000 {
		compatible = "mediatek,mt6761-scpsys\0syscon";
		reg = <0x00 0x10001000 0x00 0x1000 0x00 0x10006000 0x00 0x1000 0x00 0x14002000 0x00 0x1000 0x00 0x1020e000 0x00 0x1000 0x00 0x18004000 0x00 0x1000>;
		clocks = <0x0f 0x6b 0x0f 0x6d 0x10 0x15 0x10 0x16 0x10 0x13 0x10 0x14 0x11 0x00 0x11 0x01 0x10 0x19 0x10 0x18>;
		clock-names = "mm\0mfg\0mm-0\0mm-1\0mm-2\0mm-3\0cam-0\0cam-1\0cam-2\0cam-3";
		#clock-cells = <0x01>;
		phandle = <0x35>;
	};

	scp_infra@10001000 {
		compatible = "mediatek,scpinfra";
		reg = <0x00 0x10001000 0x00 0x1000>;
		phandle = <0x6a>;
	};

	topckgen@10000000 {
		compatible = "mediatek,mt6761-topckgen\0syscon";
		reg = <0x00 0x10000000 0x00 0x1000>;
		#clock-cells = <0x01>;
		phandle = <0x0f>;
	};

	dcm@10001000 {
		compatible = "mediatek,mt6761-dcm";
		reg = <0x00 0x10001000 0x00 0x1000 0x00 0x10200000 0x00 0x4000 0x00 0x10228000 0x00 0x2000 0x00 0x1022a000 0x00 0x2000 0x00 0x10230000 0x00 0x2000 0x00 0x10232000 0x00 0x2000 0x00 0x1022d000 0x00 0x1000 0x00 0x10235000 0x00 0x1000>;
		reg-names = "infra_ao\0mcucfg\0ddrphy0_ao\0dramc0_ao\0ddrphy1_ao\0dramc1_ao\0emi_ch0\0emi_ch1";
		phandle = <0x6b>;
	};

	io_cfg_lt@10002000 {
		compatible = "mediatek,io_cfg_lt";
		reg = <0x00 0x10002000 0x00 0x200>;
		phandle = <0x17>;
	};

	io_cfg_lm@10002200 {
		compatible = "mediatek,io_cfg_lm";
		reg = <0x00 0x10002200 0x00 0x200>;
		phandle = <0x18>;
	};

	io_cfg_lb@10002400 {
		compatible = "mediatek,io_cfg_lb";
		reg = <0x00 0x10002400 0x00 0x200>;
		phandle = <0x19>;
	};

	io_cfg_bl@10002600 {
		compatible = "mediatek,io_cfg_bl";
		reg = <0x00 0x10002600 0x00 0x200>;
		phandle = <0x1a>;
	};

	io_cfg_rr@10002800 {
		compatible = "mediatek,io_cfg_rr";
		reg = <0x00 0x10002800 0x00 0x200>;
		phandle = <0x1b>;
	};

	io_cfg_rb@10002a00 {
		compatible = "mediatek,io_cfg_rb";
		reg = <0x00 0x10002a00 0x00 0x200>;
		phandle = <0x1c>;
	};

	io_cfg_rt@10002c00 {
		compatible = "mediatek,io_cfg_rt";
		reg = <0x00 0x10002c00 0x00 0x200>;
		phandle = <0x1d>;
	};

	pericfg@10003000 {
		compatible = "mediatek,pericfg\0syscon";
		reg = <0x00 0x10003000 0x00 0x1000>;
		#clock-cells = <0x01>;
		phandle = <0x4c>;
	};

	efuse_dbg@10004000 {
		compatible = "mediatek,efuse_dbg";
		reg = <0x00 0x10004000 0x00 0x1000>;
	};

	smart_pa {
		phandle = <0x6c>;
	};

	tcpc_pd {
		phandle = <0x6d>;
	};

	md1_sim1_hot_plug_eint {
		phandle = <0x6e>;
	};

	md1_sim2_hot_plug_eint {
		phandle = <0x6f>;
	};

	gpio {
		compatible = "mediatek,gpio_usage_mapping";
		phandle = <0x70>;
	};

	gpio@10005000 {
		compatible = "mediatek,gpio\0syscon";
		reg = <0x00 0x10005000 0x00 0x1000>;
		phandle = <0x16>;
	};

	syscfg_pctl_0@10005000 {
		compatible = "mediatek,mt6761-pctl-0-syscfg\0syscon";
		reg = <0x00 0x10005000 0x00 0x1000>;
		phandle = <0x71>;
	};

	sleep@10006000 {
		compatible = "mediatek,sleep\0syscon";
		mediatek,pwrap-regmap = <0x12>;
		reg = <0x00 0x10006000 0x00 0x1000>;
		interrupts = <0x00 0x7d 0x08>;
		wakeup-source = <0x13 0x00 0x04 0x14 0x01 0x20 0x15 0x03 0x2000000>;
		phandle = <0x66>;
	};

	eint@1000b000 {
		compatible = "mediatek,eint";
		reg = <0x00 0x1000b000 0x00 0x1000>;
		phandle = <0x72>;
	};

	pinctrl@10005000 {
		compatible = "mediatek,mt6761-pinctrl";
		reg_bases = <0x16 0x17 0x18 0x19 0x1a 0x1b 0x1c 0x1d>;
		pins-are-numbered;
		gpio-controller;
		gpio-ranges = <0x1e 0x00 0x00 0xb3>;
		#gpio-cells = <0x02>;
		interrupt-controller;
		#interrupt-cells = <0x02>;
		interrupts = <0x00 0x73 0x04>;
		interrupt-parent = <0x0e>;
		phandle = <0x1e>;

		msdc0@default {
			phandle = <0x4f>;

			pins_cmd {
				drive-strength = [03];
			};

			pins_dat {
				drive-strength = [03];
			};

			pins_clk {
				drive-strength = [03];
			};

			pins_rst {
				drive-strength = [03];
			};

			pins_ds {
				drive-strength = [03];
			};
		};

		msdc0@hs400 {
			phandle = <0x50>;

			pins_cmd {
				drive-strength = [03];
			};

			pins_dat {
				drive-strength = [04];
			};

			pins_clk {
				drive-strength = [04];
			};

			pins_rst {
				drive-strength = [03];
			};

			pins_ds {
				drive-strength = [04];
			};
		};

		msdc0@hs200 {
			phandle = <0x51>;

			pins_cmd {
				drive-strength = [03];
			};

			pins_dat {
				drive-strength = [04];
			};

			pins_clk {
				drive-strength = [04];
			};

			pins_rst {
				drive-strength = [03];
			};

			pins_ds {
				drive-strength = [04];
			};
		};

		msdc0@register_default {
			cmd_edge = [00];
			rdata_edge = [00];
			wdata_edge = [00];
			phandle = <0x52>;
		};

		msdc1@default {
			phandle = <0x54>;

			pins_cmd {
				drive-strength = [03];
			};

			pins_dat {
				drive-strength = [03];
			};

			pins_clk {
				drive-strength = [03];
			};
		};

		msdc1@sdr104 {
			phandle = <0x55>;

			pins_cmd {
				drive-strength = [03];
			};

			pins_dat {
				drive-strength = [03];
			};

			pins_clk {
				drive-strength = [03];
			};
		};

		msdc1@sdr50 {
			phandle = <0x56>;

			pins_cmd {
				drive-strength = [03];
			};

			pins_dat {
				drive-strength = [03];
			};

			pins_clk {
				drive-strength = [03];
			};
		};

		msdc1@ddr50 {
			phandle = <0x57>;

			pins_cmd {
				drive-strength = [03];
			};

			pins_dat {
				drive-strength = [03];
			};

			pins_clk {
				drive-strength = [03];
			};
		};

		msdc1@register_default {
			cmd_edge = [00];
			rdata_edge = [00];
			wdata_edge = [00];
			phandle = <0x58>;
		};

		msdc3@default {
			phandle = <0x73>;

			pins_cmd {
				drive-strength = [04];
			};

			pins_dat {
				drive-strength = [04];
			};

			pins_clk {
				drive-strength = [04];
			};
		};

		msdc3@register_default {
			cmd_edge = [01];
			rdata_edge = [01];
			wdata_edge = [01];
			phandle = <0x74>;
		};

		accdetdefault {
			phandle = <0x25>;
		};

		accdeteint@0 {
			phandle = <0x26>;

			pins_cmd_dat {
				pinmux = <0x1300>;
				slew-rate = <0x00>;
				bias-disable;
			};
		};
	};

	toprgu@10007000 {
		compatible = "mediatek,mt6761-wdt\0mediatek,mt6589-wdt\0mediatek,toprgu\0syscon\0simple-mfd";
		reg = <0x00 0x10007000 0x00 0x1000>;
		interrupts = <0x00 0x53 0x00>;
		mediatek,rg_dfd_timeout = <0xa0>;
		#reset-cells = <0x01>;
		phandle = <0x45>;

		reboot-mode {
			compatible = "syscon-reboot-mode";
			offset = <0x24>;
			mask = <0x0f>;
			mode-charger = <0x01>;
			mode-recovery = <0x02>;
			mode-bootloader = <0x03>;
			mode-dm-verity-dev-corrupt = <0x04>;
			mode-kpoc = <0x05>;
			mode-ddr-reserve = <0x06>;
			mode-meta = <0x07>;
			mode-rpmbpk = <0x08>;
		};
	};

	chipid@08000000 {
		compatible = "mediatek,chipid";
		reg = <0x00 0x8000000 0x00 0x04 0x00 0x8000004 0x00 0x04 0x00 0x8000008 0x00 0x04 0x00 0x800000c 0x00 0x04>;
	};

	mobicore {
		compatible = "trustonic,mobicore";
		interrupts = <0x00 0xc2 0x01>;
	};

	tkcore {
		compatible = "trustkernel,tkcore";
		interrupts = <0x00 0xc4 0x01>;
	};

	timer {
		compatible = "arm,armv8-timer";
		interrupt-parent = <0x0e>;
		interrupts = <0x01 0x0d 0x08 0x01 0x0e 0x08 0x01 0x0b 0x08 0x01 0x0a 0x08>;
		clock-frequency = <0xc65d40>;
	};

	clocks {

		clk26m {
			compatible = "fixed-clock";
			#clock-cells = <0x00>;
			clock-frequency = <0x18cba80>;
			phandle = <0x21>;
		};

		clk13m {
			compatible = "fixed-clock";
			#clock-cells = <0x00>;
			clock-frequency = <0xc65d40>;
			phandle = <0x31>;
		};

		clk32k {
			compatible = "fixed-clock";
			#clock-cells = <0x00>;
			clock-frequency = <0x7d00>;
			phandle = <0x75>;
		};
	};

	hacc@1000a000 {
		compatible = "mediatek,hacc";
		reg = <0x00 0x1000a000 0x00 0x1000>;
		interrupts = <0x00 0x85 0x08>;
	};

	apirq@1000b000 {
		compatible = "mediatek,apirq";
		reg = <0x00 0x1000b000 0x00 0x1000>;
		interrupts = <0x00 0x73 0x04>;
	};

	regulator_vibrator {
		compatible = "regulator-vibrator";
		min-volt = <0x231860>;
		max-volt = <0x30d400>;
		min-limit = <0x0f>;
		max-limit = <0x3a98>;
		vib-supply = <0x1f>;
	};

	apmixed@1000c000 {
		compatible = "mediatek,mt6761-apmixedsys\0syscon";
		reg = <0x00 0x1000c000 0x00 0xe00>;
		#clock-cells = <0x01>;
		phandle = <0x20>;
	};

	fhctl@1000ce00 {
		compatible = "mediatek,mt6761-fhctl";
		reg = <0x00 0x1000ce00 0x00 0x100>;
		mediatek,apmixed = <0x20>;
		phandle = <0x76>;

		armpll {
			mediatek,fh-id = <0x00>;
			mediatek,fh-pll-id = <0x00>;
			mediatek,fh-cpu-pll;
		};

		mainpll {
			mediatek,fh-id = <0x01>;
			mediatek,fh-pll-id = <0x01>;
		};

		msdcpll {
			mediatek,fh-id = <0x02>;
			mediatek,fh-pll-id = <0x05>;
		};

		mfgpll {
			mediatek,fh-id = <0x03>;
			mediatek,fh-pll-id = <0x02>;
		};

		mpll {
			mediatek,fh-id = <0x05>;
			mediatek,fh-pll-id = <0x07>;
		};

		mmpll {
			mediatek,fh-id = <0x06>;
			mediatek,fh-pll-id = <0x03>;
		};
	};

	pwrap@1000d000 {
		compatible = "mediatek,mt6761-pwrap\0syscon";
		reg = <0x00 0x1000d000 0x00 0x1000>;
		reg-names = "pwrap";
		interrupts = <0x00 0x7b 0x04>;
		clocks = <0x21 0x22 0x02 0x0f 0x85>;
		clock-names = "spi\0wrap\0ulposc";
		phandle = <0x12>;

		main_pmic {
			compatible = "mediatek,mt6357";
			interrupt-controller;
			#interrupt-cells = <0x02>;
			interrupt-parent = <0x1e>;
			interrupts = <0x90 0x04 0x90 0x00>;
			phandle = <0x2d>;

			mtk_battery_oc_throttling {
				compatible = "mediatek,mt6357-battery_oc_throttling";
				oc-thd-h = <0x123e>;
				oc-thd-l = <0x157c>;
			};

			pmic_accdet {
				compatible = "mediatek,mt6357-accdet";
				accdet-name = "mt63xx-accdet";
				accdet-mic-vol = <0x06>;
				accdet-plugout-debounce = <0x01>;
				accdet-mic-mode = <0x01>;
				headset-mode-setting = <0x500 0x500 0x01 0x1f0 0x800 0x800 0x20 0x44>;
				headset-eint-level-pol = <0x08>;
				headset-use-ap-eint = <0x01>;
				headset-eint-num = <0x01>;
				headset-eint-trig-mode = <0x00>;
				headset-key-mode = <0x00>;
				headset-three-key-threshold = <0x00 0x50 0xdc 0x190>;
				headset-three-key-threshold-CDD = <0x00 0x79 0xc0 0x258>;
				headset-four-key-threshold = <0x00 0x3a 0x79 0xc0 0x190>;
				io-channels = <0x23 0x09>;
				io-channel-names = "pmic_accdet";
				nvmem = <0x24>;
				nvmem-names = "mt63xx-accdet-efuse";
				pinctrl-names = "default\0state_eint_as_int";
				pinctrl-0 = <0x25>;
				pinctrl-1 = <0x26>;
				status = "okay";
				phandle = <0x77>;
			};

			mt6357keys {
				compatible = "mediatek,mt6357-keys";
				mediatek,long-press-mode = <0x01>;
				power-off-time-sec = <0x00>;
				phandle = <0x78>;

				power {
					linux,keycodes = <0x74>;
					wakeup-source;
				};

				home {
					linux,keycodes = <0x73>;
				};
			};

			pmic_auxadc {
				compatible = "mediatek,pmic-auxadc\0mediatek,mt6357-auxadc";
				#io-channel-cells = <0x01>;
				#interconnect-cells = <0x01>;
				phandle = <0x23>;

				batadc {
					channel = <0x00>;
					resistance-ratio = <0x03 0x01>;
					avg-num = <0x80>;
				};

				isense {
					channel = <0x01>;
					resistance-ratio = <0x03 0x01>;
					avg-num = <0x80>;
				};

				vcdt {
					channel = <0x02>;
				};

				bat_temp {
					channel = <0x03>;
					resistance-ratio = <0x01 0x01>;
				};

				chip_temp {
					channel = <0x05>;
				};

				vcore_temp {
					channel = <0x06>;
				};

				vproc_temp {
					channel = <0x07>;
				};

				accdet {
					channel = <0x09>;
				};

				tsx_temp {
					channel = <0x0b>;
					avg-num = <0x80>;
				};

				hpofs_cal {
					channel = <0x0c>;
					avg-num = <0x100>;
				};

				dcxo_temp {
					channel = <0x0d>;
					avg-num = <0x10>;
				};

				vbif {
					channel = <0x0e>;
					resistance-ratio = <0x01 0x01>;
				};

				imp {
					channel = <0x0f>;
					resistance-ratio = <0x03 0x01>;
					avg-num = <0x80>;
				};

				imix_r {
					channel = <0x10>;
				};
			};

			mtk_gauge {
				compatible = "mediatek,mt6357-gauge";
				charger = <0x27>;
				bootmode = <0x28>;
				io-channels = <0x23 0x03 0x23 0x01 0x23 0x0e 0x23 0x0f 0x23 0x10>;
				io-channel-names = "pmic_battery_temp\0pmic_battery_voltage\0pmic_bif_voltage\0pmic_ptim_voltage\0pmic_ptim_r";
				nvmem-cells = <0x29 0x2a>;
				nvmem-cell-names = "initialization\0state-of-charge";
				DIFFERENCE_FULLOCV_ITH = <0xc8>;
				SHUTDOWN_1_TIME = <0x0a>;
				KEEP_100_PERCENT = <0x01>;
				R_FG_VALUE = <0x0a>;
				EMBEDDED_SEL = <0x00>;
				PMIC_SHUTDOWN_CURRENT = <0x14>;
				FG_METER_RESISTANCE = <0x4b>;
				CAR_TUNE_VALUE = <0x64>;
				PMIC_MIN_VOL = <0x82dc>;
				POWERON_SYSTEM_IBOOT = <0x1f4>;
				SHUTDOWN_GAUGE0_VOLTAGE = <0x84d0>;
				TEMPERATURE_T0 = <0x32>;
				TEMPERATURE_T1 = <0x19>;
				TEMPERATURE_T2 = <0x0a>;
				TEMPERATURE_T3 = <0x00>;
				TEMPERATURE_T4 = <0xfffffffa>;
				TEMPERATURE_T5 = <0xfffffff6>;
				g_FG_PSEUDO100_T0 = <0x64>;
				g_FG_PSEUDO100_T1 = <0x64>;
				g_FG_PSEUDO100_T2 = <0x64>;
				g_FG_PSEUDO100_T3 = <0x64>;
				g_FG_PSEUDO100_T4 = <0x64>;
				Q_MAX_SYS_VOLTAGE_BAT0 = <0xd16>;
				Q_MAX_SYS_VOLTAGE_BAT1 = <0xd16>;
				Q_MAX_SYS_VOLTAGE_BAT2 = <0xd16>;
				Q_MAX_SYS_VOLTAGE_BAT3 = <0xd16>;
				COM_FG_METER_RESISTANCE = <0x64>;
				COM_R_FG_VALUE = <0x00>;
				enable_tmp_intr_suspend = <0x00>;
				ACTIVE_TABLE = <0x06>;
				MULTI_TEMP_GAUGE0 = <0x01>;
				RBAT_PULL_UP_R = <0x4204>;
				RBAT_PULL_UP_VOLT = <0x708>;
				battery0_profile_t0_num = <0x64>;
				battery0_profile_t0_col = <0x03>;
				battery0_profile_t0 = <0x00 0xa96a 0x47e 0x133 0xa8b8 0x47e 0x266 0xa818 0x47e 0x398 0xa797 0x47e 0x4cb 0xa717 0x473 0x5fe 0xa698 0x467 0x731 0xa629 0x476 0x863 0xa5b8 0x48d 0x996 0xa543 0x4ab 0xac9 0xa4cf 0x4a3 0xbfc 0xa45c 0x49a 0xd2e 0xa3ed 0x4aa 0xe61 0xa37f 0x4b0 0xf94 0xa310 0x4b0 0x10c7 0xa2a8 0x4bf 0x11fa 0xa23d 0x4c4 0x132c 0xa1cf 0x4b5 0x145f 0xa165 0x4c6 0x1592 0xa0fd 0x4e3 0x16c5 0xa09b 0x4f2 0x17f7 0xa036 0x4fb 0x192a 0x9fce 0x4fb 0x1a5d 0x9f6f 0x52d 0x1b90 0x9f13 0x567 0x1cc2 0x9eb7 0x595 0x1df5 0x9e58 0x5b2 0x1f28 0x9df6 0x5c2 0x205b 0x9d99 0x5df 0x218d 0x9d3d 0x607 0x22c0 0x9ce1 0x644 0x23f3 0x9c89 0x66d 0x2526 0x9c33 0x68b 0x2659 0x9be4 0x69b 0x278b 0x9b94 0x6b0 0x28be 0x9b44 0x6cf 0x29f1 0x9af4 0x6ee 0x2b24 0x9aa6 0x70a 0x2c56 0x9a5c 0x71a 0x2d89 0x9a06 0x709 0x2ebc 0x99a4 0x6db 0x2fef 0x9937 0x685 0x3121 0x98c7 0x61d 0x3254 0x9852 0x593 0x3387 0x97e5 0x539 0x34ba 0x977d 0x4fb 0x35ed 0x9733 0x4cd 0x371f 0x96ee 0x4b6 0x3852 0x96b0 0x4c5 0x3985 0x9678 0x4c9 0x3ab8 0x9641 0x4c9 0x3bea 0x9610 0x4c9 0x3d1d 0x95e2 0x4d8 0x3e50 0x95b7 0x4f6 0x3f83 0x9587 0x4ee 0x40b5 0x9558 0x4e5 0x41e8 0x9533 0x4f5 0x431b 0x950b 0x504 0x444e 0x94e0 0x513 0x4581 0x94bb 0x523 0x46b3 0x9498 0x532 0x47e6 0x9479 0x541 0x4919 0x9456 0x546 0x4a4c 0x9432 0x546 0x4b7e 0x940d 0x546 0x4cb1 0x93e8 0x546 0x4de4 0x93c3 0x546 0x4f17 0x93a3 0x552 0x5049 0x9383 0x55f 0x517c 0x935e 0x55f 0x52af 0x9335 0x55f 0x53e2 0x930a 0x55f 0x5515 0x92da 0x55f 0x5647 0x92a5 0x550 0x577a 0x9267 0x522 0x58ad 0x922e 0x529 0x59e0 0x91f5 0x544 0x5b12 0x919f 0x526 0x5c45 0x9147 0x521 0x5d78 0x90eb 0x540 0x5eab 0x9080 0x521 0x5fdd 0x9020 0x4f8 0x6110 0x9007 0x4e9 0x6243 0x8ff9 0x4fb 0x6376 0x8ff3 0x529 0x64a8 0x8fe7 0x557 0x65db 0x8fd9 0x596 0x670e 0x8fc6 0x601 0x6841 0x8f35 0x627 0x6974 0x8e5a 0x628 0x6aa6 0x8c8e 0x675 0x6bd9 0x8ad9 0x6fd 0x6d0c 0x894a 0x7e3 0x6e3f 0x88a4 0x8e1 0x6f71 0x8847 0x9eb 0x70a4 0x87de 0xb1e 0x71d7 0x86ef 0xc0c 0x730a 0x8579 0xcb5 0x743c 0x8253 0x1102 0x756f 0x7e82 0x1a75 0x76a2 0x75f8 0x170c>;
				battery0_profile_t1_num = <0x64>;
				battery0_profile_t1_col = <0x03>;
				battery0_profile_t1 = <0x00 0xa96a 0x47e 0x133 0xa8b8 0x47e 0x266 0xa818 0x47e 0x398 0xa797 0x47e 0x4cb 0xa717 0x473 0x5fe 0xa698 0x467 0x731 0xa629 0x476 0x863 0xa5b8 0x48d 0x996 0xa543 0x4ab 0xac9 0xa4cf 0x4a3 0xbfc 0xa45c 0x49a 0xd2e 0xa3ed 0x4aa 0xe61 0xa37f 0x4b0 0xf94 0xa310 0x4b0 0x10c7 0xa2a8 0x4bf 0x11fa 0xa23d 0x4c4 0x132c 0xa1cf 0x4b5 0x145f 0xa165 0x4c6 0x1592 0xa0fd 0x4e3 0x16c5 0xa09b 0x4f2 0x17f7 0xa036 0x4fb 0x192a 0x9fce 0x4fb 0x1a5d 0x9f6f 0x52d 0x1b90 0x9f13 0x567 0x1cc2 0x9eb7 0x595 0x1df5 0x9e58 0x5b2 0x1f28 0x9df6 0x5c2 0x205b 0x9d99 0x5df 0x218d 0x9d3d 0x607 0x22c0 0x9ce1 0x644 0x23f3 0x9c89 0x66d 0x2526 0x9c33 0x68b 0x2659 0x9be4 0x69b 0x278b 0x9b94 0x6b0 0x28be 0x9b44 0x6cf 0x29f1 0x9af4 0x6ee 0x2b24 0x9aa6 0x70a 0x2c56 0x9a5c 0x71a 0x2d89 0x9a06 0x709 0x2ebc 0x99a4 0x6db 0x2fef 0x9937 0x685 0x3121 0x98c7 0x61d 0x3254 0x9852 0x593 0x3387 0x97e5 0x539 0x34ba 0x977d 0x4fb 0x35ed 0x9733 0x4cd 0x371f 0x96ee 0x4b6 0x3852 0x96b0 0x4c5 0x3985 0x9678 0x4c9 0x3ab8 0x9641 0x4c9 0x3bea 0x9610 0x4c9 0x3d1d 0x95e2 0x4d8 0x3e50 0x95b7 0x4f6 0x3f83 0x9587 0x4ee 0x40b5 0x9558 0x4e5 0x41e8 0x9533 0x4f5 0x431b 0x950b 0x504 0x444e 0x94e0 0x513 0x4581 0x94bb 0x523 0x46b3 0x9498 0x532 0x47e6 0x9479 0x541 0x4919 0x9456 0x546 0x4a4c 0x9432 0x546 0x4b7e 0x940d 0x546 0x4cb1 0x93e8 0x546 0x4de4 0x93c3 0x546 0x4f17 0x93a3 0x552 0x5049 0x9383 0x55f 0x517c 0x935e 0x55f 0x52af 0x9335 0x55f 0x53e2 0x930a 0x55f 0x5515 0x92da 0x55f 0x5647 0x92a5 0x550 0x577a 0x9267 0x522 0x58ad 0x922e 0x529 0x59e0 0x91f5 0x544 0x5b12 0x919f 0x526 0x5c45 0x9147 0x521 0x5d78 0x90eb 0x540 0x5eab 0x9080 0x521 0x5fdd 0x9020 0x4f8 0x6110 0x9007 0x4e9 0x6243 0x8ff9 0x4fb 0x6376 0x8ff3 0x529 0x64a8 0x8fe7 0x557 0x65db 0x8fd9 0x596 0x670e 0x8fc6 0x601 0x6841 0x8f35 0x627 0x6974 0x8e5a 0x628 0x6aa6 0x8c8e 0x675 0x6bd9 0x8ad9 0x6fd 0x6d0c 0x894a 0x7e3 0x6e3f 0x88a4 0x8e1 0x6f71 0x8847 0x9eb 0x70a4 0x87de 0xb1e 0x71d7 0x86ef 0xc0c 0x730a 0x8579 0xcb5 0x743c 0x8253 0x1102 0x756f 0x7e82 0x1a75 0x76a2 0x75f8 0x170c>;
				battery0_profile_t2_num = <0x64>;
				battery0_profile_t2_col = <0x03>;
				battery0_profile_t2 = <0x00 0xa9ba 0x4e2 0x133 0xa8fc 0x4e2 0x266 0xa815 0x50f 0x398 0xa6e8 0x58a 0x4cb 0xa5f2 0x682 0x5fe 0xa516 0x796 0x731 0xa473 0x833 0x863 0xa3df 0x897 0x996 0xa358 0x8c5 0xac9 0xa2e6 0x8f3 0xbfc 0xa278 0x919 0xd2e 0xa20a 0x928 0xe61 0xa19f 0x94b 0xf94 0xa137 0x979 0x10c7 0xa0c8 0x979 0x11fa 0xa05e 0x984 0x132c 0x9ffc 0x9a3 0x145f 0x9f9e 0x9c2 0x1592 0x9f44 0x9e2 0x16c5 0x9ef9 0xa11 0x17f7 0x9e9f 0xa30 0x192a 0x9e37 0xa3f 0x1a5d 0x9db9 0xa5c 0x1b90 0x9d3b 0xa7b 0x1cc2 0x9cc7 0xa99 0x1df5 0x9c65 0xaae 0x1f28 0x9c0f 0xabe 0x205b 0x9bcb 0xaeb 0x218d 0x9b87 0xb0f 0x22c0 0x9b43 0xb1e 0x23f3 0x9af5 0xb22 0x2526 0x9aa5 0xb20 0x2659 0x9a4f 0xb11 0x278b 0x99f3 0xaf2 0x28be 0x9991 0xac4 0x29f1 0x9924 0xa6e 0x2b24 0x98b6 0xa15 0x2c56 0x984c 0x9c7 0x2d89 0x97eb 0x98d 0x2ebc 0x978f 0x95f 0x2fef 0x973f 0x931 0x3121 0x96f7 0x91b 0x3254 0x96b9 0x92a 0x3387 0x9680 0x92e 0x34ba 0x964a 0x930 0x35ed 0x9618 0x940 0x371f 0x95e6 0x94f 0x3852 0x95b5 0x95e 0x3985 0x958f 0x989 0x3ab8 0x9569 0x9af 0x3bea 0x953e 0x9be 0x3d1d 0x9513 0x9c4 0x3e50 0x94e8 0x9c4 0x3f83 0x94c9 0x9f3 0x40b5 0x94a7 0xa15 0x41e8 0x9482 0xa25 0x431b 0x9462 0xa34 0x444e 0x9443 0xa48 0x4581 0x9425 0xa76 0x46b3 0x9409 0xa94 0x47e6 0x93f1 0xaa3 0x4919 0x93c7 0xaa5 0x4a4c 0x939d 0xaa1 0x4b7e 0x9378 0xa91 0x4cb1 0x9358 0xaa0 0x4de4 0x9339 0xabe 0x4f17 0x9314 0xace 0x5049 0x92ea 0xad7 0x517c 0x92b9 0xad7 0x52af 0x927f 0xad7 0x53e2 0x923f 0xad9 0x5515 0x91f4 0xae9 0x5647 0x91a0 0xae8 0x577a 0x9144 0xad8 0x58ad 0x90f3 0xad7 0x59e0 0x90af 0xad3 0x5b12 0x908b 0xac3 0x5c45 0x9072 0xaf0 0x5d78 0x9060 0xb3e 0x5eab 0x9053 0xbb9 0x5fdd 0x9042 0xc5a 0x6110 0x9029 0xd35 0x6243 0x8fc2 0xe19 0x6376 0x8f13 0xecb 0x64a8 0x8d5f 0xe7e 0x65db 0x8b73 0xe3a 0x670e 0x8957 0xdfd 0x6841 0x88a0 0xf0e 0x6974 0x880f 0x109f 0x6aa6 0x8782 0x1323 0x6bd9 0x8603 0x15ed 0x6d0c 0x83e1 0x1979 0x6e3f 0x7f66 0x284b 0x6f71 0x7652 0x17d4 0x70a4 0x7652 0x17d4 0x71d7 0x7652 0x17d4 0x730a 0x7652 0x17d4 0x743c 0x7652 0x17d4 0x756f 0x7652 0x17d4 0x76a2 0x7652 0x17d4>;
				battery0_profile_t3_num = <0x64>;
				battery0_profile_t3_col = <0x03>;
				battery0_profile_t3 = <0x00 0xa9a6 0x721 0x133 0xa925 0x721 0x266 0xa8a9 0x72c 0x398 0xa834 0x74b 0x4cb 0xa7bb 0x75e 0x5fe 0xa73f 0x76f 0x731 0xa6b5 0x78f 0x863 0xa614 0x7a6 0x996 0xa55c 0x7b5 0xac9 0xa468 0x867 0xbfc 0xa377 0x969 0xd2e 0xa2a7 0xb16 0xe61 0xa1f5 0xc81 0xf94 0xa155 0xdc3 0x10c7 0xa0d1 0xe51 0x11fa 0xa056 0xeb8 0x132c 0x9fe8 0xee6 0x145f 0x9f8c 0xf14 0x1592 0x9f37 0xf46 0x16c5 0x9ee7 0xf93 0x17f7 0x9e7c 0xfb9 0x192a 0x9df5 0xfb9 0x1a5d 0x9d66 0xfe2 0x1b90 0x9cdc 0x1008 0x1cc2 0x9c61 0x1018 0x1df5 0x9bfe 0x103b 0x1f28 0x9ba9 0x1069 0x205b 0x9b65 0x1087 0x218d 0x9b1f 0x109a 0x22c0 0x9ad6 0x109a 0x23f3 0x9a86 0x108e 0x2526 0x9a32 0x107a 0x2659 0x99d0 0x104c 0x278b 0x996e 0x101d 0x28be 0x990c 0xfef 0x29f1 0x98a4 0xfb4 0x2b24 0x983f 0xf7f 0x2c56 0x97e3 0xf60 0x2d89 0x978e 0xf4b 0x2ebc 0x973d 0xf3d 0x2fef 0x96f9 0xf4c 0x3121 0x96bb 0xf5b 0x3254 0x9684 0xf6b 0x3387 0x9651 0xf92 0x34ba 0x9620 0xfbe 0x35ed 0x95ef 0xfdc 0x371f 0x95be 0xffb 0x3852 0x958d 0x101a 0x3985 0x9567 0x1038 0x3ab8 0x9540 0x105b 0x3bea 0x9515 0x108a 0x3d1d 0x94e9 0x10af 0x3e50 0x94bf 0x10cd 0x3f83 0x949a 0x10ec 0x40b5 0x9475 0x1111 0x41e8 0x9450 0x113f 0x431b 0x9430 0x116d 0x444e 0x940f 0x1196 0x4581 0x93e4 0x11a6 0x46b3 0x93bf 0x11c6 0x47e6 0x93a0 0x11f4 0x4919 0x9376 0x1206 0x4a4c 0x934b 0x1223 0x4b7e 0x9321 0x1260 0x4cb1 0x92ed 0x1289 0x4de4 0x92b6 0x12a9 0x4f17 0x927e 0x12d7 0x5049 0x9243 0x130d 0x517c 0x9206 0x134a 0x52af 0x91ba 0x1356 0x53e2 0x916d 0x135e 0x5515 0x9130 0x138c 0x5647 0x90fd 0x13cb 0x577a 0x90d2 0x1418 0x58ad 0x90b1 0x149f 0x59e0 0x9094 0x1548 0x5b12 0x907c 0x162e 0x5c45 0x905f 0x175e 0x5d78 0x903c 0x18af 0x5eab 0x8fda 0x19f1 0x5fdd 0x8f26 0x1ade 0x6110 0x8e06 0x1b58 0x6243 0x8c3c 0x1b26 0x6376 0x8a5f 0x1af7 0x64a8 0x88e3 0x1b81 0x65db 0x87da 0x1d9e 0x670e 0x8728 0x20ea 0x6841 0x8528 0x2581 0x6974 0x823a 0x2b52 0x6aa6 0x7c70 0x261e 0x6bd9 0x78b4 0x1ccf 0x6d0c 0x78b4 0x1ccf 0x6e3f 0x78b4 0x1ccf 0x6f71 0x78b4 0x1ccf 0x70a4 0x78b4 0x1ccf 0x71d7 0x78b4 0x1ccf 0x730a 0x78b4 0x1ccf 0x743c 0x78b4 0x1ccf 0x756f 0x78b4 0x1ccf 0x76a2 0x78b4 0x1ccf>;
				battery0_profile_t4_num = <0x64>;
				battery0_profile_t4_col = <0x03>;
				battery0_profile_t4 = <0x00 0xa956 0xbb8 0x133 0xa8cf 0xbb8 0x266 0xa84d 0xbc3 0x398 0xa7d2 0xbe2 0x4cb 0xa75a 0xbf6 0x5fe 0xa6e4 0xc03 0x731 0xa676 0xc03 0x863 0xa60a 0xc13 0x996 0xa5a2 0xc31 0xac9 0xa53a 0xc5e 0xbfc 0xa4d0 0xc84 0xd2e 0xa462 0xc93 0xe61 0xa3f2 0xcad 0xf94 0xa381 0xccb 0x10c7 0xa313 0xcdb 0x11fa 0xa2ae 0xd15 0x132c 0xa258 0xd8f 0x145f 0xa1e1 0xe16 0x1592 0xa151 0xeae 0x16c5 0xa05b 0xfa4 0x17f7 0x9f66 0x1182 0x192a 0x9e72 0x1442 0x1a5d 0x9da4 0x1694 0x1b90 0x9ce0 0x18a7 0x1cc2 0x9c2e 0x1a36 0x1df5 0x9ba4 0x1b12 0x1f28 0x9b30 0x1b8b 0x205b 0x9ad4 0x1bb9 0x218d 0x9a7c 0x1bfa 0x22c0 0x9a2b 0x1c57 0x23f3 0x99d1 0x1c77 0x2526 0x9973 0x1c7f 0x2659 0x990b 0x1c60 0x278b 0x98a6 0x1c52 0x28be 0x9844 0x1c52 0x29f1 0x97ec 0x1c60 0x2b24 0x9798 0x1c6f 0x2c56 0x9748 0x1c7f 0x2d89 0x9708 0x1cac 0x2ebc 0x96cf 0x1ce9 0x2fef 0x9692 0x1d08 0x3121 0x9657 0x1d3a 0x3254 0x9620 0x1d87 0x3387 0x95f2 0x1dd3 0x34ba 0x95c6 0x1e1e 0x35ed 0x9595 0x1e5b 0x371f 0x9564 0x1ea9 0x3852 0x9532 0x1f07 0x3985 0x9506 0x1f55 0x3ab8 0x94d9 0x1fa2 0x3bea 0x94a8 0x1fef 0x3d1d 0x947b 0x2046 0x3e50 0x9450 0x20a1 0x3f83 0x9412 0x20ee 0x40b5 0x93d7 0x2141 0x41e8 0x939f 0x219f 0x431b 0x9362 0x21fc 0x444e 0x9324 0x2255 0x4581 0x92e0 0x22a2 0x46b3 0x92a0 0x2308 0x47e6 0x9263 0x2382 0x4919 0x9220 0x23e1 0x4a4c 0x91de 0x2459 0x4b7e 0x919f 0x2515 0x4cb1 0x9161 0x25ee 0x4de4 0x9124 0x26d5 0x4f17 0x90ed 0x27ca 0x5049 0x90b6 0x28da 0x517c 0x907f 0x2a0d 0x52af 0x9039 0x2b4c 0x53e2 0x8fe3 0x2c8d 0x5515 0x8f53 0x2dc6 0x5647 0x8e81 0x2ea3 0x577a 0x8d7f 0x2f3c 0x58ad 0x8be1 0x2f53 0x59e0 0x8a33 0x2fba 0x5b12 0x887a 0x30dd 0x5c45 0x86cd 0x3465 0x5d78 0x8513 0x389f 0x5eab 0x8193 0x32bf 0x5fdd 0x7ca6 0x2742 0x6110 0x7ca6 0x2742 0x6243 0x7ca6 0x2742 0x6376 0x7ca6 0x2742 0x64a8 0x7ca6 0x2742 0x65db 0x7ca6 0x2742 0x670e 0x7ca6 0x2742 0x6841 0x7ca6 0x2742 0x6974 0x7ca6 0x2742 0x6aa6 0x7ca6 0x2742 0x6bd9 0x7ca6 0x2742 0x6d0c 0x7ca6 0x2742 0x6e3f 0x7ca6 0x2742 0x6f71 0x7ca6 0x2742 0x70a4 0x7ca6 0x2742 0x71d7 0x7ca6 0x2742 0x730a 0x7ca6 0x2742 0x743c 0x7ca6 0x2742 0x756f 0x7ca6 0x2742 0x76a2 0x7ca6 0x2742>;
				battery0_profile_t5_num = <0x64>;
				battery0_profile_t5_col = <0x03>;
				battery0_profile_t5 = <0x00 0xa956 0xbb8 0x133 0xa8cf 0xbb8 0x266 0xa84d 0xbc3 0x398 0xa7d2 0xbe2 0x4cb 0xa75a 0xbf6 0x5fe 0xa6e4 0xc03 0x731 0xa676 0xc03 0x863 0xa60a 0xc13 0x996 0xa5a2 0xc31 0xac9 0xa53a 0xc5e 0xbfc 0xa4d0 0xc84 0xd2e 0xa462 0xc93 0xe61 0xa3f2 0xcad 0xf94 0xa381 0xccb 0x10c7 0xa313 0xcdb 0x11fa 0xa2ae 0xd15 0x132c 0xa258 0xd8f 0x145f 0xa1e1 0xe16 0x1592 0xa151 0xeae 0x16c5 0xa05b 0xfa4 0x17f7 0x9f66 0x1182 0x192a 0x9e72 0x1442 0x1a5d 0x9da4 0x1694 0x1b90 0x9ce0 0x18a7 0x1cc2 0x9c2e 0x1a36 0x1df5 0x9ba4 0x1b12 0x1f28 0x9b30 0x1b8b 0x205b 0x9ad4 0x1bb9 0x218d 0x9a7c 0x1bfa 0x22c0 0x9a2b 0x1c57 0x23f3 0x99d1 0x1c77 0x2526 0x9973 0x1c7f 0x2659 0x990b 0x1c60 0x278b 0x98a6 0x1c52 0x28be 0x9844 0x1c52 0x29f1 0x97ec 0x1c60 0x2b24 0x9798 0x1c6f 0x2c56 0x9748 0x1c7f 0x2d89 0x9708 0x1cac 0x2ebc 0x96cf 0x1ce9 0x2fef 0x9692 0x1d08 0x3121 0x9657 0x1d3a 0x3254 0x9620 0x1d87 0x3387 0x95f2 0x1dd3 0x34ba 0x95c6 0x1e1e 0x35ed 0x9595 0x1e5b 0x371f 0x9564 0x1ea9 0x3852 0x9532 0x1f07 0x3985 0x9506 0x1f55 0x3ab8 0x94d9 0x1fa2 0x3bea 0x94a8 0x1fef 0x3d1d 0x947b 0x2046 0x3e50 0x9450 0x20a1 0x3f83 0x9412 0x20ee 0x40b5 0x93d7 0x2141 0x41e8 0x939f 0x219f 0x431b 0x9362 0x21fc 0x444e 0x9324 0x2255 0x4581 0x92e0 0x22a2 0x46b3 0x92a0 0x2308 0x47e6 0x9263 0x2382 0x4919 0x9220 0x23e1 0x4a4c 0x91de 0x2459 0x4b7e 0x919f 0x2515 0x4cb1 0x9161 0x25ee 0x4de4 0x9124 0x26d5 0x4f17 0x90ed 0x27ca 0x5049 0x90b6 0x28da 0x517c 0x907f 0x2a0d 0x52af 0x9039 0x2b4c 0x53e2 0x8fe3 0x2c8d 0x5515 0x8f53 0x2dc6 0x5647 0x8e81 0x2ea3 0x577a 0x8d7f 0x2f3c 0x58ad 0x8be1 0x2f53 0x59e0 0x8a33 0x2fba 0x5b12 0x887a 0x30dd 0x5c45 0x86cd 0x3465 0x5d78 0x8513 0x389f 0x5eab 0x8193 0x32bf 0x5fdd 0x7ca6 0x2742 0x6110 0x7ca6 0x2742 0x6243 0x7ca6 0x2742 0x6376 0x7ca6 0x2742 0x64a8 0x7ca6 0x2742 0x65db 0x7ca6 0x2742 0x670e 0x7ca6 0x2742 0x6841 0x7ca6 0x2742 0x6974 0x7ca6 0x2742 0x6aa6 0x7ca6 0x2742 0x6bd9 0x7ca6 0x2742 0x6d0c 0x7ca6 0x2742 0x6e3f 0x7ca6 0x2742 0x6f71 0x7ca6 0x2742 0x70a4 0x7ca6 0x2742 0x71d7 0x7ca6 0x2742 0x730a 0x7ca6 0x2742 0x743c 0x7ca6 0x2742 0x756f 0x7ca6 0x2742 0x76a2 0x7ca6 0x2742>;
				phandle = <0x62>;
			};

			mtk_charger_type {
				compatible = "mediatek,mt6357-charger-type";
				io-channels = <0x23 0x02>;
				io-channel-names = "pmic_vbus";
				bc12_active = <0x00>;
				phandle = <0x79>;
			};

			mt6357_charger {
				compatible = "mediatek,mt6357-pulse-charger";
				charger_name = "primary_chg";
				alias_name = "mt6357";
				ichg = <0x7a120>;
				cv = <0x426030>;
				vcdt_hv_thres = <0x6acfc0>;
				vbat_ov_thres = <0x43e6d0>;
				phandle = <0x7a>;
			};

			mtk_ts_pmic {
				compatible = "mediatek,mtk_ts_pmic";
				io-channels = <0x23 0x05 0x23 0x06 0x23 0x07>;
				io-channel-names = "pmic_chip_temp\0pmic_buck1_temp\0pmic_buck2_temp";
				interconnects = <0x23 0x01>;
				#interconnect-cells = <0x01>;
				phandle = <0x2b>;
			};

			mt6357_ts_buck1 {
				compatible = "mediatek,mt6357_ts_buck1";
				io-channels = <0x23 0x06>;
				io-channel-names = "pmic_buck1_temp";
				interconnects = <0x2b 0x01>;
				phandle = <0x7b>;
			};

			mt6357_ts_buck2 {
				compatible = "mediatek,mt6357_ts_buck2";
				io-channels = <0x23 0x07>;
				io-channel-names = "pmic_buck2_temp";
				interconnects = <0x2b 0x01>;
				phandle = <0x7c>;
			};

			pmic_efuse {
				compatible = "mediatek,mt6357-efuse";
				#address-cells = <0x01>;
				#size-cells = <0x01>;
				phandle = <0x24>;
			};

			mt6357regulator {
				compatible = "mediatek,mt6357-regulator";
				phandle = <0x7d>;

				buck_vs1 {
					regulator-name = "vs1";
					regulator-min-microvolt = <0x124f80>;
					regulator-max-microvolt = <0x2191c0>;
					regulator-ramp-delay = <0x30d4>;
					regulator-enable-ramp-delay = <0xdc>;
					phandle = <0x7e>;
				};

				buck_vmodem {
					regulator-name = "vmodem";
					regulator-min-microvolt = <0x7a120>;
					regulator-max-microvolt = <0x123716>;
					regulator-ramp-delay = <0x186a>;
					regulator-enable-ramp-delay = <0xdc>;
					phandle = <0x36>;
				};

				buck_vcore {
					regulator-name = "vcore";
					regulator-min-microvolt = <0x7ea5e>;
					regulator-max-microvolt = <0x1406f4>;
					regulator-ramp-delay = <0x186a>;
					regulator-enable-ramp-delay = <0xdc>;
					phandle = <0x37>;
				};

				buck_vproc {
					regulator-name = "vproc";
					regulator-min-microvolt = <0x7ea5e>;
					regulator-max-microvolt = <0x1406f4>;
					regulator-ramp-delay = <0x186a>;
					regulator-enable-ramp-delay = <0xdc>;
					phandle = <0x7f>;
				};

				buck_vpa {
					regulator-name = "vpa";
					regulator-min-microvolt = <0x7a120>;
					regulator-max-microvolt = <0x37b1d0>;
					regulator-ramp-delay = <0xc350>;
					regulator-enable-ramp-delay = <0xdc>;
					phandle = <0x80>;
				};

				ldo_vfe28 {
					regulator-name = "vfe28";
					regulator-min-microvolt = <0x2ab980>;
					regulator-max-microvolt = <0x2ab980>;
					regulator-enable-ramp-delay = <0x108>;
					phandle = <0x81>;
				};

				ldo_vxo22 {
					regulator-name = "vxo22";
					regulator-min-microvolt = <0x2191c0>;
					regulator-max-microvolt = <0x249f00>;
					regulator-enable-ramp-delay = <0x6e>;
					phandle = <0x82>;
				};

				ldo_vrf18 {
					regulator-name = "vrf18";
					regulator-min-microvolt = <0x1b7740>;
					regulator-max-microvolt = <0x1b7740>;
					regulator-enable-ramp-delay = <0x6e>;
					phandle = <0x83>;
				};

				ldo_vrf12 {
					regulator-name = "vrf12";
					regulator-min-microvolt = <0x124f80>;
					regulator-max-microvolt = <0x124f80>;
					regulator-enable-ramp-delay = <0x6e>;
					phandle = <0x84>;
				};

				ldo_vefuse {
					regulator-name = "vefuse";
					regulator-min-microvolt = <0x124f80>;
					regulator-max-microvolt = <0x325aa0>;
					regulator-enable-ramp-delay = <0x108>;
					phandle = <0x85>;
				};

				ldo_vcn33_bt {
					regulator-name = "vcn33_bt";
					regulator-min-microvolt = <0x325aa0>;
					regulator-max-microvolt = <0x3567e0>;
					regulator-enable-ramp-delay = <0x108>;
					phandle = <0x86>;
				};

				ldo_vcn33_wifi {
					regulator-name = "vcn33_wifi";
					regulator-min-microvolt = <0x325aa0>;
					regulator-max-microvolt = <0x3567e0>;
					regulator-enable-ramp-delay = <0x108>;
					phandle = <0x87>;
				};

				ldo_vcn28 {
					regulator-name = "vcn28";
					regulator-min-microvolt = <0x2ab980>;
					regulator-max-microvolt = <0x2ab980>;
					regulator-enable-ramp-delay = <0x108>;
					phandle = <0x88>;
				};

				ldo_vcn18 {
					regulator-name = "vcn18";
					regulator-min-microvolt = <0x1b7740>;
					regulator-max-microvolt = <0x1b7740>;
					regulator-enable-ramp-delay = <0x108>;
					phandle = <0x89>;
				};

				ldo_vcama {
					regulator-name = "vcama";
					regulator-min-microvolt = <0x2625a0>;
					regulator-max-microvolt = <0x2ab980>;
					regulator-enable-ramp-delay = <0x108>;
					phandle = <0x8a>;
				};

				ldo_vcamd {
					regulator-name = "vcamd";
					regulator-min-microvolt = <0xf4240>;
					regulator-max-microvolt = <0x1b7740>;
					regulator-enable-ramp-delay = <0x108>;
					phandle = <0x8b>;
				};

				ldo_vcamio {
					regulator-name = "vcamio";
					regulator-min-microvolt = <0x1b7740>;
					regulator-max-microvolt = <0x1b7740>;
					regulator-enable-ramp-delay = <0x108>;
					phandle = <0x8c>;
				};

				ldo_vldo28 {
					regulator-name = "vldo28";
					regulator-min-microvolt = <0x2ab980>;
					regulator-max-microvolt = <0x2dc6c0>;
					regulator-enable-ramp-delay = <0x108>;
					phandle = <0x60>;
				};

				ldo_vsram_others {
					regulator-name = "vsram_others";
					regulator-min-microvolt = <0x7ea5e>;
					regulator-max-microvolt = <0x1406f4>;
					regulator-ramp-delay = <0x186a>;
					regulator-enable-ramp-delay = <0x6e>;
					phandle = <0x8d>;
				};

				ldo_vsram_proc {
					regulator-name = "vsram_proc";
					regulator-min-microvolt = <0x7ea5e>;
					regulator-max-microvolt = <0x1406f4>;
					regulator-ramp-delay = <0x186a>;
					regulator-enable-ramp-delay = <0x6e>;
					phandle = <0x8e>;
				};

				ldo_vaux18 {
					regulator-name = "vaux18";
					regulator-min-microvolt = <0x1b7740>;
					regulator-max-microvolt = <0x1b7740>;
					regulator-enable-ramp-delay = <0x108>;
					phandle = <0x8f>;
				};

				ldo_vaud28 {
					regulator-name = "vaud28";
					regulator-min-microvolt = <0x2ab980>;
					regulator-max-microvolt = <0x2ab980>;
					regulator-enable-ramp-delay = <0x108>;
					phandle = <0x90>;
				};

				ldo_vio28 {
					regulator-name = "vio28";
					regulator-min-microvolt = <0x2ab980>;
					regulator-max-microvolt = <0x2ab980>;
					regulator-enable-ramp-delay = <0x108>;
					phandle = <0x91>;
				};

				ldo_vio18 {
					regulator-name = "vio18";
					regulator-min-microvolt = <0x1b7740>;
					regulator-max-microvolt = <0x1b7740>;
					regulator-enable-ramp-delay = <0x108>;
					phandle = <0x92>;
				};

				ldo_vdram {
					regulator-name = "vdram";
					regulator-min-microvolt = <0x10c8e0>;
					regulator-max-microvolt = <0x124f80>;
					regulator-enable-ramp-delay = <0xce4>;
					phandle = <0x93>;
				};

				ldo_vmc {
					regulator-name = "vmc";
					regulator-min-microvolt = <0x1b7740>;
					regulator-max-microvolt = <0x325aa0>;
					regulator-enable-ramp-delay = <0x2c>;
					phandle = <0x5a>;
				};

				ldo_vmch {
					regulator-name = "vmch";
					regulator-min-microvolt = <0x2c4020>;
					regulator-max-microvolt = <0x325aa0>;
					regulator-enable-ramp-delay = <0x2c>;
					phandle = <0x59>;
				};

				ldo_vemc {
					regulator-name = "vemc";
					regulator-min-microvolt = <0x2c4020>;
					regulator-max-microvolt = <0x325aa0>;
					regulator-enable-ramp-delay = <0x2c>;
					phandle = <0x53>;
				};

				ldo_vsim1 {
					regulator-name = "vsim1";
					regulator-min-microvolt = <0x19f0a0>;
					regulator-max-microvolt = <0x2f4d60>;
					regulator-enable-ramp-delay = <0x108>;
					phandle = <0x94>;
				};

				ldo_vsim2 {
					regulator-name = "vsim2";
					regulator-min-microvolt = <0x19f0a0>;
					regulator-max-microvolt = <0x2f4d60>;
					regulator-enable-ramp-delay = <0x108>;
					phandle = <0x95>;
				};

				ldo_vibr {
					regulator-name = "vibr";
					regulator-min-microvolt = <0x124f80>;
					regulator-max-microvolt = <0x325aa0>;
					regulator-enable-ramp-delay = <0x2c>;
					phandle = <0x1f>;
				};

				ldo_vusb33 {
					regulator-name = "vusb33";
					regulator-min-microvolt = <0x2dc6c0>;
					regulator-max-microvolt = <0x2f4d60>;
					regulator-enable-ramp-delay = <0x108>;
					phandle = <0x96>;
				};
			};

			mtk_dynamic_loading_throttling {
				compatible = "mediatek,mt6357-dynamic_loading_throttling";
				mediatek,charger = <0x2c>;
				uvlo-level = <0xa28>;
				isense_support;
				io-channels = <0x23 0x0f 0x23 0x10 0x23 0x01 0x23 0x00>;
				io-channel-names = "pmic_ptim\0pmic_imix_r\0pmic_isense\0pmic_batadc";
			};

			pmic_lbat_service {
				compatible = "mediatek,mt6357-lbat_service";
			};

			mt6357_debug {
				compatible = "mediatek,mt63xx-debug";
			};

			mt63xx-oc-debug {
				compatible = "mediatek,mt63xx-oc-debug";
			};

			leds-mt6357 {
				compatible = "mediatek,mt6357_leds";

				Isink1 {
					reg = <0x01>;
					label = "red";
					linux,default-trigger = "none";
					default-state = "off";
				};
			};

			mtk_rtc {
				compatible = "mediatek,mt6357-rtc";
				#address-cells = <0x01>;
				#size-cells = <0x01>;
				bootmode = <0x28>;
				phandle = <0x97>;

				fg_init {
					reg = <0x00 0x01>;
					bits = <0x00 0x08>;
					phandle = <0x29>;
				};

				fg_soc {
					reg = <0x01 0x01>;
					bits = <0x00 0x08>;
					phandle = <0x2a>;
				};

				ext_32k {
					reg = <0x02 0x01>;
					bits = <0x06 0x01>;
					phandle = <0x98>;
				};
			};

			pmic_codec {
				compatible = "mediatek,mt6357-sound";
				mediatek,pwrap-regmap = <0x12>;
				nvmem = <0x24>;
				nvmem-names = "pmic-hp-efuse";
				io-channels = <0x23 0x0c 0x23 0x09>;
				io-channel-names = "pmic_codec\0pmic_accdet";
				use_hp_depop_flow = <0x00>;
				use_ul_260k = <0x00>;
				phandle = <0x99>;
			};

			clock_buffer_ctrl {
				compatible = "mediatek,clock_buffer";
				n-clkbuf-pmic-dependent = <0x0a>;
				clkbuf-pmic-dependent = "pmic-drvcurr\0pmic-auxout-sel\0pmic-auxout-xo\0pmic-auxout-drvcurr\0pmic-auxout-bblpm-en\0pmic-cofst-fpm\0pmic-cdac-fpm\0pmic-core-idac-fpm\0pmic-aac-fpm-swen\0pmic-heater-sel";
				pmic-dcxo-cw = <0x788>;
				pmic-xo-mode = <0x788 0x00 0x788 0x03 0x788 0x06 0x788 0x09 0xffff 0xffff 0x7a2 0x08 0x7a2 0x0b>;
				pmic-xo-en = <0x788 0x02 0x788 0x05 0x788 0x08 0x788 0x0b 0xffff 0xffff 0x7a2 0x0a 0x7a2 0x0d>;
				pmic-bblpm-sw = <0x788 0x0c>;
				pmic-srclkeni3 = <0x44a 0x00>;
				n-pmic-drvcurr = <0x07>;
				pmic-drvcurr = <0x7b0 0x00 0x7b0 0x02 0x7b0 0x04 0x7b0 0x06 0xffff 0xffff 0x7b0 0x0a 0x7b0 0x0c>;
				n-pmic-auxout-sel = <0x06>;
				pmic-auxout-sel = <0x7b4 0x00 0x7b4 0x05 0x7b4 0x06 0x7b4 0x07 0x7b4 0x06 0x7b4 0x18>;
				n-pmic-auxout-xo = <0x07>;
				pmic-auxout-xo = <0x7b6 0x00 0x7b6 0x06 0x7b6 0x00 0x7b6 0x06 0xffff 0xffff 0x7b6 0x06 0x7b6 0x0c>;
				n-pmic-auxout-drvcurr = <0x07>;
				pmic-auxout-drvcurr = <0x7b6 0x01 0x7b6 0x07 0x7b6 0x01 0x7b6 0x07 0xffff 0xffff 0x7b6 0x01 0x7b6 0x0c>;
				n-pmic-auxout-bblpm-en = <0x01>;
				pmic-auxout-bblpm-en = <0x7b6 0x00>;
				n-pmic-cofst-fpm = <0x01>;
				pmic-cofst-fpm = <0x796 0x0e>;
				n-pmic-cdac-fpm = <0x01>;
				pmic-cdac-fpm = <0x794 0x00>;
				n-pmic-core-idac-fpm = <0x01>;
				pmic-core-idac-fpm = <0x79a 0x0e>;
				n-pmic-aac-fpm-swen = <0x01>;
				pmic-aac-fpm-swen = <0x79e 0x0e>;
				n-pmic-heater-sel = <0x01>;
				pmic-heater-sel = <0x7b8 0x01>;
				phandle = <0x9a>;
			};
		};
	};

	scp@10500000 {
		compatible = "mediatek,scp";
		status = "okay";
		reg = <0x00 0x10500000 0x00 0x40000 0x00 0x105c0000 0x00 0x3000 0x00 0x105c4000 0x00 0x1000 0x00 0x105d4000 0x00 0x6000>;
		interrupts = <0x00 0x88 0x04>;
		core_1 = "enable";
		scp_sramSize = <0x40000>;
		scp_mpuRegionId = <0x1b>;
		scp_feature_tbl = <0x00 0x2f 0x01 0x164 0x02 0x3e 0x03 0x2f 0x04 0x1a 0x05 0x00 0x06 0xc8 0x07 0x00 0x08 0x64 0x09 0x0a>;
		scp_mem_key = "mediatek,reserve-memory-scp_share";
		scp_mem_tbl = <0x01 0x100000 0x04 0x200000>;
		phandle = <0x9b>;
	};

	scp_dvfs {
		compatible = "mediatek,scp_dvfs";
		clocks = <0x0f 0x6c 0x21 0x0f 0x10 0x0f 0x1d 0x0f 0x04 0x0f 0x1a 0x0f 0x08 0x0f 0x1c>;
		clock-names = "clk_mux\0clk_pll_0\0clk_pll_1\0clk_pll_2\0clk_pll_3\0clk_pll_4\0clk_pll_5\0clk_pll_6";
		dvfsrc-opp-num = <0x03>;
		dvfs-opp = <0xff 0xff 0xff 0x00 0x00 0xfa 0x00 0xff 0xff 0xff 0x00 0x00 0x111 0x03 0xff 0xff 0xff 0x02 0x08 0x14a 0x05 0xff 0xff 0xff 0x03 0x0c 0x1a0 0x06>;
		pmic = <0x2d>;
		pmic-feature = "pmic-vow-lp\0pmic-pmrc";
		pmic-feature-cfg = <0x00 0x00>;
		gpio = <0x16 0x01>;
		gpio-feature = "gpio-mode";
		gpio-feature-cfg = <0x00>;
	};

	sleep_reg_md@1000f000 {
		compatible = "mediatek,sleep_reg_md";
		reg = <0x00 0x1000f000 0x00 0x1000>;
	};

	kp@10010000 {
		compatible = "mediatek,kp";
		reg = <0x00 0x10010000 0x00 0x1000>;
		interrupts = <0x00 0x7c 0x02>;
		clocks = <0x21>;
		clock-names = "kpd";
		phandle = <0x13>;
	};

	mrdump_ext_rst {
		compatible = "mediatek, mrdump_ext_rst-eint";
		mode = "IRQ";
		status = "okay";
		phandle = <0x9c>;
	};

	touch {
		compatible = "goodix,touch";
		phandle = <0x9d>;
	};

	accdet_eint {
		compatible = "mtk,accdet_eint";
		phandle = <0x9e>;
	};

	accdet {
		compatible = "mediatek,pmic-accdet";
		phandle = <0x9f>;
	};

	irqkey_drv {
		compatible = "new-mobi,irq_key_drv";
		phandle = <0xa0>;
	};

	fingerprint {
		compatible = "mediatek,goodix-fp";
		phandle = <0xa1>;
	};

	topmisc@10011000 {
		compatible = "mediatek,topmisc";
		reg = <0x00 0x10011000 0x00 0x1000>;
	};

	dvfsrc@10012000 {
		compatible = "mediatek,mt6761-dvfsrc";
		reg = <0x00 0x10012000 0x00 0x1000 0x00 0x10006000 0x00 0x1000>;
		reg-names = "dvfsrc\0spm";
		#address-cells = <0x02>;
		#size-cells = <0x02>;
		ranges;
		phandle = <0xa2>;

		opp2 {
			opp-level = <0x02>;
			phandle = <0x30>;
		};

		opp1 {
			opp-level = <0x01>;
			phandle = <0x2f>;
		};

		opp0 {
			opp-level = <0x00>;
			phandle = <0x2e>;
		};

		dvfsrc-up {
			compatible = "mediatek,mt6761-dvfsrc-up";
		};

		dvfsrc-debug {
			compatible = "mediatek,mt6761-dvfsrc-debug";
			required-opps = <0x2e 0x2f 0x30>;
		};

		dvfsrc-met {
			compatible = "mediatek,mt6761-dvfsrc-met";
		};

		qos@00110b80 {
			compatible = "mediatek,mt6761-qos";
			reg = <0x00 0x110b80 0x00 0x80>;
		};
	};

	mbist_ao@10013000 {
		compatible = "mediatek,mbist_ao";
		reg = <0x00 0x10013000 0x00 0x1000>;
	};

	apcldmain_ao@10014000 {
		compatible = "mediatek,apcldmain_ao";
		reg = <0x00 0x10014000 0x00 0x400>;
	};

	apcldmaout_ao@10014400 {
		compatible = "mediatek,apcldmaout_ao";
		reg = <0x00 0x10014400 0x00 0x400>;
	};

	apcldmamisc_ao@10014800 {
		compatible = "mediatek,apcldmamisc_ao";
		reg = <0x00 0x10014800 0x00 0x400>;
	};

	apcldmamisc_ao@10014c00 {
		compatible = "mediatek,apcldmamisc_ao";
		reg = <0x00 0x10014c00 0x00 0x400>;
	};

	aes_top0@10016000 {
		compatible = "mediatek,aes_top0";
		reg = <0x00 0x10016000 0x00 0x1000>;
	};

	timer@10017000 {
		compatible = "mediatek,sys_timer\0mediatek,mt6761-timer\0mediatek,mt6765-timer";
		reg = <0x00 0x10017000 0x00 0x1000>;
		reg-names = "sys_timer_base";
		interrupts = <0x00 0x8a 0x04>;
		clocks = <0x31>;
		phandle = <0xa3>;
	};

	modem_temp_share@10018000 {
		compatible = "mediatek,modem_temp_share";
		reg = <0x00 0x10018000 0x00 0x1000>;
	};

	security_ao@1001a000 {
		compatible = "mediatek,security_ao";
		reg = <0x00 0x1001a000 0x00 0x1000>;
	};

	topckgen_ao@1001b000 {
		compatible = "mediatek,topckgen_ao";
		reg = <0x00 0x1001b000 0x00 0x1000>;
	};

	iocfg_0@10002000 {
		compatible = "mediatek,iocfg_0";
		reg = <0x00 0x10002000 0x00 0x200>;
	};

	iocfg_1@10002200 {
		compatible = "mediatek,iocfg_1";
		reg = <0x00 0x10002200 0x00 0x200>;
	};

	iocfg_2@10002400 {
		compatible = "mediatek,iocfg_2";
		reg = <0x00 0x10002400 0x00 0x200>;
	};

	iocfg_3@10002600 {
		compatible = "mediatek,iocfg_3";
		reg = <0x00 0x10002600 0x00 0x200>;
	};

	iocfg_4@10002800 {
		compatible = "mediatek,iocfg_4";
		reg = <0x00 0x10002800 0x00 0x200>;
	};

	iocfg_5@10002a00 {
		compatible = "mediatek,iocfg_5";
		reg = <0x00 0x10002a00 0x00 0x200>;
	};

	mdcldmain_ao@10015000 {
		compatible = "mediatek,mdcldmain_ao";
		reg = <0x00 0x10015000 0x00 0x400>;
	};

	mdcldmaout_ao@10015400 {
		compatible = "mediatek,mdcldmaout_ao";
		reg = <0x00 0x10015400 0x00 0x400>;
	};

	mdcldmamisc_ao@10015800 {
		compatible = "mediatek,mdcldmamisc_ao";
		reg = <0x00 0x10015800 0x00 0x400>;
	};

	sys_cirq@10204000 {
		compatible = "mediatek,sys_cirq";
		reg = <0x00 0x10204000 0x00 0x1000>;
		mediatek,cirq_num = <0xd1>;
		mediatek,spi_start_offset = <0x10>;
		interrupts = <0x00 0xe0 0x08>;
	};

	mcucfg@10200000 {
		compatible = "mediatek,mcucfg";
		reg = <0x00 0x10200000 0x00 0x200>;
		interrupts = <0x00 0x00 0x04>;
	};

	mcucfg@10200200 {
		compatible = "mediatek,mcucfg";
		reg = <0x00 0x10200200 0x00 0x200>;
		interrupts = <0x00 0x01 0x08>;
	};

	mcucfg@10200400 {
		compatible = "mediatek,mcucfg";
		reg = <0x00 0x10200400 0x00 0x200>;
		interrupts = <0x00 0x02 0x04>;
	};

	mcucfg@10200600 {
		compatible = "mediatek,mcucfg";
		reg = <0x00 0x10200600 0x00 0x200>;
		interrupts = <0x00 0x03 0x04>;
	};

	mcucfg@10200800 {
		compatible = "mediatek,mcucfg";
		reg = <0x00 0x10200800 0x00 0x200>;
		interrupts = <0x00 0x04 0x04>;
	};

	mcucfg@10200a00 {
		compatible = "mediatek,mcucfg";
		reg = <0x00 0x10200a00 0x00 0x300>;
		interrupts = <0x00 0x05 0x08>;
	};

	mcucfg@10200f00 {
		compatible = "mediatek,mcucfg";
		reg = <0x00 0x10200f00 0x00 0x100>;
		interrupts = <0x00 0x06 0x08>;
	};

	mcucfg@10201000 {
		compatible = "mediatek,mcucfg";
		reg = <0x00 0x10201000 0x00 0x1000>;
		interrupts = <0x00 0x07 0x08>;
	};

	mcucfg@10202000 {
		compatible = "mediatek,mcucfg";
		reg = <0x00 0x10202000 0x00 0x1000>;
		interrupts = <0x00 0x08 0x08>;
	};

	mcucfg@10203000 {
		compatible = "mediatek,mcucfg";
		reg = <0x00 0x10203000 0x00 0x1000>;
		interrupts = <0x00 0x09 0x08>;
	};

	mcucfg_mp0_counter@10200000 {
		compatible = "mediatek,mcucfg_mp0_counter";
		reg = <0x00 0x10200000 0x00 0x4000>;
	};

	m4u@10205000 {
		cell-index = <0x00>;
		compatible = "mediatek,iommu_v0";
		reg = <0x00 0x10205000 0x00 0x1000>;
		mediatek,larbs = <0x32 0x33 0x34>;
		interrupts = <0x00 0x66 0x08>;
		#iommu-cells = <0x01>;
		phandle = <0x67>;
	};

	devapc@10207000 {
		compatible = "mediatek,devapc";
		reg = <0x00 0x10207000 0x00 0x1000>;
		interrupts = <0x00 0x56 0x08>;
		clocks = <0x22 0x28>;
		clock-names = "devapc-infra-clock";
	};

	hwrng {
		compatible = "mediatek,mt67xx-rng";
		phandle = <0xa4>;
	};

	bus_dbg@10208000 {
		compatible = "mediatek,bus_dbg-v2";
		reg = <0x00 0x10208000 0x00 0x1000 0x00 0x10001000 0x00 0x1000>;
		mediatek,bus_dbg_con_offset = <0x2fc>;
		interrupts = <0x00 0x55 0x08>;
	};

	ap_ccif0@10209000 {
		compatible = "mediatek,ap_ccif0";
		reg = <0x00 0x10209000 0x00 0x1000>;
		interrupts = <0x00 0x5c 0x08>;
	};

	md_ccif0@1020a000 {
		compatible = "mediatek,md_ccif0";
		reg = <0x00 0x1020a000 0x00 0x1000>;
	};

	ap_ccif1@1020b000 {
		compatible = "mediatek,ap_ccif1";
		reg = <0x00 0x1020b000 0x00 0x1000>;
		interrupts = <0x00 0x5e 0x08>;
	};

	md_ccif1@1020c000 {
		compatible = "mediatek,md_ccif1";
		reg = <0x00 0x1020c000 0x00 0x1000>;
	};

	infra_mbist@1020d000 {
		compatible = "mediatek,infra_mbist";
		reg = <0x00 0x1020d000 0x00 0x1000>;
	};

	infracfg@1020e000 {
		compatible = "mediatek,infracfg";
		reg = <0x00 0x1020e000 0x00 0x1000>;
	};

	trng@1020f000 {
		compatible = "mediatek,trng";
		reg = <0x00 0x1020f000 0x00 0x1000>;
		interrupts = <0x00 0x69 0x08>;
	};

	dxcc_sec@10210000 {
		compatible = "mediatek,dxcc_sec";
		reg = <0x00 0x10210000 0x00 0x1000>;
		interrupts = <0x00 0x6a 0x04>;
	};

	mcupm_sram2@10211000 {
		compatible = "mediatek,mcupm_sram2";
		reg = <0x00 0x10211000 0x00 0x1000>;
	};

	cq_dma@10212000 {
		compatible = "mediatek,mt-cqdma-v1";
		reg = <0x00 0x10212000 0x00 0x80 0x00 0x10212080 0x00 0x80 0x00 0x10212100 0x00 0x68>;
		interrupts = <0x00 0x39 0x08 0x00 0x3a 0x08 0x00 0x3b 0x08>;
		nr_channel = <0x03>;
		keep_clock_ao = "yes";
		clocks = <0x22 0x43>;
		clock-names = "cqdma";
	};

	mcupm_sram3@10213000 {
		compatible = "mediatek,mcupm_sram3";
		reg = <0x00 0x10213000 0x00 0x1000>;
	};

	sramrom@10214000 {
		compatible = "mediatek,sramrom";
		reg = <0x00 0x10214000 0x00 0x1000>;
	};

	mcupm_reg@10216000 {
		compatible = "mediatek,mcupm_reg";
		reg = <0x00 0x10216000 0x00 0x1000>;
	};

	mcupm_sram0@10217000 {
		compatible = "mediatek,mcupm_sram0";
		reg = <0x00 0x10217000 0x00 0x1000>;
	};

	mcupm_sram1@10218000 {
		compatible = "mediatek,mcupm_sram1";
		reg = <0x00 0x10218000 0x00 0x1000>;
	};

	emi@10219000 {
		compatible = "mediatek,emi";
		reg = <0x00 0x10219000 0x00 0x1000 0x00 0x10226000 0x00 0x1000 0x00 0x1022d000 0x00 0x1000 0x00 0x10235000 0x00 0x1000>;
		interrupts = <0x00 0x58 0x08>;
	};

	apcldmain@1021b000 {
		compatible = "mediatek,apcldmain";
		reg = <0x00 0x1021b000 0x00 0x100>;
	};

	apcldmaout@1021b400 {
		compatible = "mediatek,apcldmaout";
		reg = <0x00 0x1021b400 0x00 0x100>;
	};

	apcldmamisc@1021b800 {
		compatible = "mediatek,apcldmamisc";
		reg = <0x00 0x1021b800 0x00 0x100>;
		interrupts = <0x00 0x6d 0x04>;
	};

	mdcldmain@1021c000 {
		compatible = "mediatek,mdcldmain";
		reg = <0x00 0x1021c000 0x00 0x400>;
	};

	mdcldmaout@1021c400 {
		compatible = "mediatek,mdcldmaout";
		reg = <0x00 0x1021c400 0x00 0x400>;
	};

	mdcldmamisc@1021c800 {
		compatible = "mediatek,mdcldmamisc";
		reg = <0x00 0x1021c800 0x00 0x1000>;
	};

	ccifdriver@10209000 {
		compatible = "mediatek,ccci_ccif";
		reg = <0x00 0x10209000 0x00 0x1000 0x00 0x1020a000 0x00 0x1000>;
		mediatek,sram_size = <0x200>;
		interrupts = <0x00 0x5c 0x08 0x00 0x5d 0x08>;
		clocks = <0x22 0x29 0x22 0x2c 0x22 0x23 0x22 0x24 0x22 0x58 0x22 0x59>;
		clock-names = "infra-ccif-ap\0infra-ccif-md\0infra-ccif1-ap\0infra-ccif1-md\0infra-ccif2-ap\0infra-ccif2-md";
		phandle = <0xa5>;
	};

	cldmadriver@10014000 {
		compatible = "mediatek,ccci_cldma";
		reg = <0x00 0x10014000 0x00 0x1000 0x00 0x1021b000 0x00 0x1000>;
		interrupts = <0x00 0x6d 0x04>;
		mediatek,cldma_capability = <0x06>;
		mediatek,md_generation = <0x1895>;
		mediatek,platform = <0x1a69>;
		clocks = <0x22 0x32>;
		clock-names = "infra-cldma-bclk";
		cldma-infracfg = <0x22>;
		phandle = <0xa6>;
	};

	mddriver@10014000 {
		compatible = "mediatek,mddriver\0mediatek,mddriver-mt6761";
		reg = <0x00 0x10014000 0x00 0x1000 0x00 0x1021b000 0x00 0x1000 0x00 0x10209000 0x00 0x1000 0x00 0x1020a000 0x00 0x1000>;
		interrupts = <0x00 0x6d 0x04 0x00 0x5c 0x08 0x00 0x5d 0x08 0x00 0xcd 0x02>;
		mediatek,mdhif_type = <0x03>;
		mediatek,md_id = <0x00>;
		mediatek,ap_plat_info = <0x1a69>;
		mediatek,md_generation = <0x1895>;
		mediatek,offset_apon_md1 = <0x1c24>;
		mediatek,cldma_capability = <0x06>;
		clocks = <0x35 0x00 0x22 0x32 0x22 0x29 0x22 0x2c 0x22 0x23 0x22 0x24 0x22 0x58 0x22 0x59>;
		clock-names = "scp-sys-md1-main\0infra-cldma-bclk\0infra-ccif-ap\0infra-ccif-md\0infra-ccif1-ap\0infra-ccif1-md\0infra-ccif2-ap\0infra-ccif2-md";
		_vmodem-supply = <0x36>;
		_vcore-supply = <0x37>;
		ccci-infracfg = <0x22>;
		phandle = <0x15>;
	};

	md_auxadc {
		compatible = "mediatek,md_auxadc";
		io-channels = <0x38 0x02>;
		io-channel-names = "md-channel\0md-battery";
		phandle = <0xa7>;
	};

	bpi_bsi_slv0@1021e000 {
		compatible = "mediatek,bpi_bsi_slv0";
		reg = <0x00 0x1021e000 0x00 0x1000>;
	};

	bpi_bsi_slv1@1021f000 {
		compatible = "mediatek,bpi_bsi_slv1";
		reg = <0x00 0x1021f000 0x00 0x6000>;
	};

	bpi_bsi_slv2@10225000 {
		compatible = "mediatek,bpi_bsi_slv2";
		reg = <0x00 0x10225000 0x00 0x1000>;
	};

	dvfsp@10227000 {
		compatible = "mediatek,dvfsp";
		reg = <0x00 0x10227000 0x00 0x1000>;
	};

	dvfsp@00110c00 {
		compatible = "mediatek,mt6761-dvfsp";
		reg = <0x00 0x110c00 0x00 0x1400 0x00 0x110c00 0x00 0x1400>;
		nvmem-cells = <0x39>;
		nvmem-cell-names = "efuse_segment_cell";
	};

	dramc@1022a000 {
		compatible = "mediatek,dramc";
		reg = <0x00 0x1022a000 0x00 0x2000 0x00 0x10232000 0x00 0x2000 0x00 0x1022c000 0x00 0x1000 0x00 0x10234000 0x00 0x1000 0x00 0x10228000 0x00 0x2000 0x00 0x10230000 0x00 0x2000 0x00 0x1022e000 0x00 0x1000 0x00 0x10236000 0x00 0x1000>;
	};

	gce@10238000 {
		compatible = "mediatek,gce\0syscon";
		reg = <0x00 0x10238000 0x00 0x4000>;
		interrupts = <0x00 0x62 0x08>;
		g3d_config_base = <0x13000000 0x00 0xffff0000>;
		mmsys_config_base = <0x14000000 0x01 0xffff0000>;
		disp_dither_base = <0x14010000 0x02 0xffff0000>;
		mm_na_base = <0x14020000 0x03 0xffff0000>;
		imgsys_base = <0x15020000 0x04 0xffff0000>;
		vdec_gcon_base = <0x18800000 0x05 0xffff0000>;
		venc_gcon_base = <0x18810000 0x06 0xffff0000>;
		conn_peri_base = <0x18820000 0x07 0xffff0000>;
		topckgen_base = <0x18830000 0x08 0xffff0000>;
		kp_base = <0x18840000 0x09 0xffff0000>;
		scp_sram_base = <0x10000000 0x0a 0xffff0000>;
		infra_na3_base = <0x10010000 0x0b 0xffff0000>;
		infra_na4_base = <0x10020000 0x0c 0xffff0000>;
		scp_base = <0x10030000 0x0d 0xffff0000>;
		mcucfg_base = <0x10040000 0x0e 0xffff0000>;
		gcpu_base = <0x10050000 0x0f 0xffff0000>;
		usb0_base = <0x10200000 0x10 0xffff0000>;
		usb_sif_base = <0x10280000 0x11 0xffff0000>;
		audio_base = <0x17000000 0x12 0xffff0000>;
		vdec_base = <0x17010000 0x13 0xffff0000>;
		msdc2_base = <0x17020000 0x14 0xffff0000>;
		vdec1_base = <0x17030000 0x15 0xffff0000>;
		msdc3_base = <0x18000000 0x16 0xffff0000>;
		ap_dma_base = <0x18010000 0x17 0xffff0000>;
		gce_base = <0x18020000 0x18 0xffff0000>;
		vdec2_base = <0x18040000 0x19 0xffff0000>;
		vdec3_base = <0x18050000 0x1a 0xffff0000>;
		camsys_base = <0x18080000 0x1b 0xffff0000>;
		camsys1_base = <0x180a0000 0x1c 0xffff0000>;
		camsys2_base = <0x180b0000 0x1d 0xffff0000>;
		pwm_sw_base = <0x1100e000 0x63 0xffff0000>;
		mipitx0_base = <0x11c80000 0x63 0xffff0000>;
		mdp_rdma0_sof = <0x00>;
		mdp_ccorr0_sof = <0x01>;
		mdp_rsz0_sof = <0x02>;
		mdp_rsz1_sof = <0x03>;
		mdp_wdma_sof = <0x04>;
		mdp_wrot0_sof = <0x05>;
		mdp_tdshp0_sof = <0x06>;
		disp_ovl0_sof = <0x07>;
		disp_2l_ovl0_sof = <0x08>;
		disp_rdma0_sof = <0x09>;
		disp_wdma0_sof = <0x0a>;
		disp_color0_sof = <0x0b>;
		disp_ccorr0_sof = <0x0c>;
		disp_aal0_sof = <0x0d>;
		disp_gamma0_sof = <0x0e>;
		disp_dither0_sof = <0x0f>;
		disp_dsi0_sof = <0x10>;
		disp_rsz0_sof = <0x11>;
		img_dl_relay_sof = <0x12>;
		disp_pwm0_sof = <0x13>;
		mdp_rdma0_frame_done = <0x14>;
		mdp_ccorr0_frame_done = <0x15>;
		mdp_rsz0_frame_done = <0x16>;
		mdp_rsz1_frame_done = <0x17>;
		mdp_wrot0_write_frame_done = <0x18>;
		mdp_wdma_frame_done = <0x19>;
		mdp_tdshp0_frame_done = <0x1a>;
		disp_ovl0_frame_done = <0x1b>;
		disp_2l_ovl0_frame_done = <0x1c>;
		disp_rsz0_frame_done = <0x1d>;
		disp_rdma0_frame_done = <0x1e>;
		disp_wdma0_frame_done = <0x1f>;
		disp_color0_frame_done = <0x20>;
		disp_ccorr0_frame_done = <0x21>;
		disp_aal0_frame_done = <0x22>;
		disp_gamma0_frame_done = <0x23>;
		disp_dither0_frame_done = <0x24>;
		disp_dsi0_frame_done = <0x25>;
		stream_done_0 = <0x82>;
		stream_done_1 = <0x83>;
		stream_done_2 = <0x84>;
		stream_done_3 = <0x85>;
		stream_done_4 = <0x86>;
		stream_done_5 = <0x87>;
		stream_done_6 = <0x88>;
		stream_done_7 = <0x89>;
		stream_done_8 = <0x8a>;
		stream_done_9 = <0x8b>;
		buf_underrun_event_0 = <0x8c>;
		dsi0_te_event = <0x8d>;
		dsi0_irq_event = <0x8e>;
		dsi0_done_event = <0x8f>;
		disp_wdma0_rst_done = <0x93>;
		mdp_wdma_rst_done = <0x94>;
		mdp_wrot0_rst_done = <0x95>;
		mdp_rdma0_rst_done = <0x97>;
		disp_ovl0_frame_rst_done_pusle = <0x98>;
		dip_cq_thread2_frame_done = <0x101>;
		dip_cq_thread1_frame_done = <0x102>;
		dip_cq_thread0_frame_done = <0x103>;
		isp_frame_done_p1_1 = <0x104>;
		isp_frame_done_p1_0 = <0x105>;
		camsv_0_pass1_done = <0x106>;
		camsv_1_pass1_done = <0x107>;
		seninf_0_fifo_full = <0x108>;
		seninf_1_fifo_full = <0x109>;
		seninf_2_fifo_full = <0x10a>;
		seninf_3_fifo_full = <0x10b>;
		seninf_4_fifo_full = <0x10c>;
		seninf_5_fifo_full = <0x10d>;
		seninf_6_fifo_full = <0x10e>;
		seninf_7_fifo_full = <0x10f>;
		venc_done = <0x121>;
		jpgenc_done = <0x122>;
		jpgdec_done = <0x123>;
		venc_mb_done = <0x124>;
		venc_128byte_cnt_done = <0x125>;
		max_prefetch_cnt = <0x01>;
		prefetch_size = <0x60>;
		sram_size_cpr_64 = <0x40>;
		mmsys_config = <0x3a>;
		mdp_rdma0 = <0x3b>;
		mdp_rsz0 = <0x3c>;
		mdp_rsz1 = <0x3d>;
		mdp_wdma0 = <0x3e>;
		mdp_wrot0 = <0x3f>;
		mdp_tdshp0 = <0x40>;
		mdp_color0 = <0x41>;
		mdp_ccorr0 = <0x42>;
		mm_mutex = <0x43>;
		sram_share_cnt = <0x01>;
		sram_share_engine = <0x0a>;
		sram_share_event = <0x2c6>;
		clocks = <0x22 0x09 0x22 0x18>;
		clock-names = "GCE\0GCE_TIMER";
		mediatek,mailbox-gce = <0x44>;
		thread_count = <0x10>;
		secure_thread = <0x08 0x0a>;
		mboxes = <0x44 0x00 0x00 0x04 0x44 0x01 0x00 0x04 0x44 0x02 0x00 0x05 0x44 0x03 0x00 0x04 0x44 0x04 0x00 0x04 0x44 0x05 0x00 0x04 0x44 0x06 0xc8 0x03 0x44 0x07 0xffffffff 0x02 0x44 0x08 0x00 0x01 0x44 0x09 0x00 0x01 0x44 0x0a 0x00 0x01 0x44 0x0b 0x00 0x01 0x44 0x0c 0x00 0x01 0x44 0x0d 0x00 0x01 0x44 0x0e 0x00 0x01 0x44 0x0f 0x00 0x01>;
		phandle = <0xa8>;
	};

	gce_mbox@10238000 {
		compatible = "mediatek,mt6761-gce";
		reg = <0x00 0x10238000 0x00 0x4000>;
		interrupts = <0x00 0x62 0x08>;
		#mbox-cells = <0x03>;
		#gce-event-cells = <0x01>;
		#gce-subsys-cells = <0x02>;
		default_tokens = [02 bc 02 bd 02 be 02 bf 02 c0 02 c6 02 c7];
		clocks = <0x22 0x09 0x22 0x18>;
		clock-names = "gce\0gce-timer";
		phandle = <0x44>;
	};

	ap_ccif2@1023c000 {
		compatible = "mediatek,ap_ccif2";
		reg = <0x00 0x1023c000 0x00 0x1000>;
		interrupts = <0x00 0x57 0x08>;
	};

	md_ccif2@1023d000 {
		compatible = "mediatek,md_ccif2";
		reg = <0x00 0x1023d000 0x00 0x1000>;
	};

	ap_ccif3@1023e000 {
		compatible = "mediatek,ap_ccif3";
		reg = <0x00 0x1023e000 0x00 0x1000>;
		interrupts = <0x00 0x5a 0x08>;
	};

	md_ccif3@1023f000 {
		compatible = "mediatek,md_ccif3";
		reg = <0x00 0x1023f000 0x00 0x1000>;
	};

	sspm@10440000 {
		compatible = "mediatek,mt6761-sspm";
		reg = <0x00 0x10440000 0x00 0x10000 0x00 0x10450000 0x00 0x100 0x00 0x10451000 0x00 0x08 0x00 0x10460000 0x00 0x100 0x00 0x10461000 0x00 0x08 0x00 0x10470000 0x00 0x100 0x00 0x10471000 0x00 0x08 0x00 0x10480000 0x00 0x100 0x00 0x10481000 0x00 0x08 0x00 0x10490000 0x00 0x100 0x00 0x10491000 0x00 0x08>;
		reg-names = "cfgreg\0mbox0_base\0mbox0_ctrl\0mbox1_base\0mbox1_ctrl\0mbox2_base\0mbox2_ctrl\0mbox3_base\0mbox3_ctrl\0mbox4_base\0mbox4_ctrl";
		interrupts = <0x00 0x92 0x04 0x00 0x95 0x04 0x00 0x96 0x04 0x00 0x97 0x04 0x00 0x98 0x04 0x00 0x99 0x04>;
		interrupt-names = "ipc\0mbox0\0mbox1\0mbox2\0mbox3\0mbox4";
	};

	gic500@0c000000 {
		compatible = "mediatek,gic500";
		reg = <0x00 0xc000000 0x00 0x400000>;
	};

	gic_cpu@0c400000 {
		compatible = "mediatek,gic_cpu";
		reg = <0x00 0xc400000 0x00 0x40000>;
	};

	dfd@10200b00 {
		compatible = "mediatek,dfd";
		reg = <0x00 0x10200b00 0x00 0x10000>;
		mediatek,enabled = <0x01>;
		mediatek,chain_length = <0x61a8>;
		mediatek,rg_dfd_timeout = <0xa0>;
		mediatek,check_dfd_support = <0x01>;
		mediatek,dfd_infra_base = <0x390>;
		mediatek,dfd_ap_addr_offset = <0x18>;
		mediatek,dfd_latch_offset = <0x48>;
		reg_base = <0x45>;
	};

	dbg_cti@0d020000 {
		compatible = "mediatek,dbg_cti";
		reg = <0x00 0xd020000 0x00 0x10000>;
	};

	dbg_etr@0d030000 {
		compatible = "mediatek,dbg_etr";
		reg = <0x00 0xd030000 0x00 0x10000>;
	};

	dbg_funnel@0d040000 {
		compatible = "mediatek,dbg_funnel";
		reg = <0x00 0xd040000 0x00 0x10000>;
	};

	dbg_dem@0d0a0000 {
		compatible = "mediatek,dbg_dem";
		reg = <0x00 0xd0a0000 0x00 0x10000>;
		interrupts = <0x00 0x54 0x08>;
	};

	dbg_mdsys1@0d0c0000 {
		compatible = "mediatek,dbg_mdsys1";
		reg = <0x00 0xd0c0000 0x00 0x40000>;
	};

	dbg_apmcu_mp0@0d400000 {
		compatible = "mediatek,dbg_apmcu_mp0";
		reg = <0x00 0xd400000 0x00 0x1000>;
	};

	dbg_apmcu_mp0@0d410000 {
		compatible = "mediatek,dbg_apmcu_mp0";
		reg = <0x00 0xd410000 0x00 0x1000>;
	};

	dbg_apmcu_mp0@0d420000 {
		compatible = "mediatek,dbg_apmcu_mp0";
		reg = <0x00 0xd420000 0x00 0x1000>;
	};

	dbg_apmcu_mp0@0d430000 {
		compatible = "mediatek,dbg_apmcu_mp0";
		reg = <0x00 0xd430000 0x00 0x1000>;
	};

	dbg_apmcu_mp0@0d440000 {
		compatible = "mediatek,dbg_apmcu_mp0";
		reg = <0x00 0xd440000 0x00 0x1000>;
	};

	dbg_apmcu_mp0@0d510000 {
		compatible = "mediatek,dbg_apmcu_mp0";
		reg = <0x00 0xd510000 0x00 0x1000>;
	};

	dbg_apmcu_mp0@0d520000 {
		compatible = "mediatek,dbg_apmcu_mp0";
		reg = <0x00 0xd520000 0x00 0x1000>;
	};

	dbg_apmcu_mp0@0d530000 {
		compatible = "mediatek,dbg_apmcu_mp0";
		reg = <0x00 0xd530000 0x00 0x1000>;
	};

	dbg_apmcu_mp0@0d540000 {
		compatible = "mediatek,dbg_apmcu_mp0";
		reg = <0x00 0xd540000 0x00 0x1000>;
	};

	dbg_apmcu_mp0@0d610000 {
		compatible = "mediatek,dbg_apmcu_mp0";
		reg = <0x00 0xd610000 0x00 0x1000>;
	};

	dbg_apmcu_mp0@0d620000 {
		compatible = "mediatek,dbg_apmcu_mp0";
		reg = <0x00 0xd620000 0x00 0x1000>;
	};

	dbg_apmcu_mp0@0d630000 {
		compatible = "mediatek,dbg_apmcu_mp0";
		reg = <0x00 0xd630000 0x00 0x1000>;
	};

	dbg_apmcu_mp0@0d640000 {
		compatible = "mediatek,dbg_apmcu_mp0";
		reg = <0x00 0xd640000 0x00 0x1000>;
	};

	dbg_apmcu_mp0@0d710000 {
		compatible = "mediatek,dbg_apmcu_mp0";
		reg = <0x00 0xd710000 0x00 0x1000>;
	};

	dbg_apmcu_mp0@0d720000 {
		compatible = "mediatek,dbg_apmcu_mp0";
		reg = <0x00 0xd720000 0x00 0x1000>;
	};

	dbg_apmcu_mp0@0d730000 {
		compatible = "mediatek,dbg_apmcu_mp0";
		reg = <0x00 0xd730000 0x00 0x1000>;
	};

	dbg_apmcu_mp0@0d740000 {
		compatible = "mediatek,dbg_apmcu_mp0";
		reg = <0x00 0xd740000 0x00 0x1000>;
	};

	dbg_apmcu_mp1@0d800000 {
		compatible = "mediatek,dbg_apmcu_mp1";
		reg = <0x00 0xd800000 0x00 0x1000>;
	};

	dbg_apmcu_mp1@0d810000 {
		compatible = "mediatek,dbg_apmcu_mp1";
		reg = <0x00 0xd810000 0x00 0x1000>;
	};

	dbg_apmcu_mp1@0d820000 {
		compatible = "mediatek,dbg_apmcu_mp1";
		reg = <0x00 0xd820000 0x00 0x1000>;
	};

	dbg_apmcu_mp1@0d830000 {
		compatible = "mediatek,dbg_apmcu_mp1";
		reg = <0x00 0xd830000 0x00 0x1000>;
	};

	dbg_apmcu_mp1@0d840000 {
		compatible = "mediatek,dbg_apmcu_mp1";
		reg = <0x00 0xd840000 0x00 0x1000>;
	};

	dbg_apmcu_mp1@0d910000 {
		compatible = "mediatek,dbg_apmcu_mp1";
		reg = <0x00 0xd910000 0x00 0x1000>;
	};

	dbg_apmcu_mp1@0d920000 {
		compatible = "mediatek,dbg_apmcu_mp1";
		reg = <0x00 0xd920000 0x00 0x1000>;
	};

	dbg_apmcu_mp1@0d930000 {
		compatible = "mediatek,dbg_apmcu_mp1";
		reg = <0x00 0xd930000 0x00 0x1000>;
	};

	dbg_apmcu_mp1@0d940000 {
		compatible = "mediatek,dbg_apmcu_mp1";
		reg = <0x00 0xd940000 0x00 0x1000>;
	};

	dbg_apmcu_mp1@0da10000 {
		compatible = "mediatek,dbg_apmcu_mp1";
		reg = <0x00 0xda10000 0x00 0x1000>;
	};

	dbg_apmcu_mp1@0da20000 {
		compatible = "mediatek,dbg_apmcu_mp1";
		reg = <0x00 0xda20000 0x00 0x1000>;
	};

	dbg_apmcu_mp1@0da30000 {
		compatible = "mediatek,dbg_apmcu_mp1";
		reg = <0x00 0xda30000 0x00 0x1000>;
	};

	dbg_apmcu_mp1@0da40000 {
		compatible = "mediatek,dbg_apmcu_mp1";
		reg = <0x00 0xda40000 0x00 0x1000>;
	};

	dbg_apmcu_mp1@0db10000 {
		compatible = "mediatek,dbg_apmcu_mp1";
		reg = <0x00 0xdb10000 0x00 0x1000>;
	};

	dbg_apmcu_mp1@0db20000 {
		compatible = "mediatek,dbg_apmcu_mp1";
		reg = <0x00 0xdb20000 0x00 0x1000>;
	};

	dbg_apmcu_mp1@0db30000 {
		compatible = "mediatek,dbg_apmcu_mp1";
		reg = <0x00 0xdb30000 0x00 0x1000>;
	};

	dbg_apmcu_mp1@0db40000 {
		compatible = "mediatek,dbg_apmcu_mp1";
		reg = <0x00 0xdb40000 0x00 0x1000>;
	};

	ap_dma@11000000 {
		compatible = "mediatek,ap_dma";
		reg = <0x00 0x11000000 0x00 0x1000>;
		interrupts = <0x00 0x29 0x08>;
	};

	auxadc@11001000 {
		compatible = "mediatek,mt6765-auxadc";
		reg = <0x00 0x11001000 0x00 0x1000>;
		interrupts = <0x00 0x14 0x02>;
		clocks = <0x22 0x21>;
		clock-names = "main";
		#io-channel-cells = <0x01>;
		mediatek,cali-en-bit = <0x14>;
		mediatek,cali-ge-bit = <0x0a>;
		mediatek,cali-oe-bit = <0x00>;
		mediatek,cali-efuse-reg-offset = <0x1a8>;
		nvmem = <0x46>;
		nvmem-names = "mtk_efuse";
		#interconnect-cells = <0x01>;
		phandle = <0x38>;
	};

	dma-controller@11000580 {
		compatible = "mediatek,mt6577-uart-dma";
		reg = <0x00 0x11000680 0x00 0x80 0x00 0x11000700 0x00 0x80 0x00 0x11000780 0x00 0x80 0x00 0x11000800 0x00 0x80>;
		interrupts = <0x00 0x35 0x08 0x00 0x36 0x08 0x00 0x37 0x08 0x00 0x3c 0x08>;
		clocks = <0x22 0x26>;
		clock-names = "apdma";
		dma-requests = <0x04>;
		dma-bits = <0x22>;
		#dma-cells = <0x01>;
		phandle = <0x47>;
	};

	serial@11020000 {
		compatible = "mediatek,mt6761-uart\0mediatek,mt6577-uart";
		reg = <0x00 0x11002000 0x00 0x1000>;
		interrupts = <0x00 0x23 0x08>;
		clocks = <0x21 0x22 0x16>;
		clock-names = "baud\0bus";
		dmas = <0x47 0x00 0x47 0x01>;
		dma-names = "tx\0rx";
		phandle = <0xa9>;
	};

	serial@11030000 {
		compatible = "mediatek,mt6761-uart\0mediatek,mt6577-uart";
		reg = <0x00 0x11003000 0x00 0x1000>;
		interrupts = <0x00 0x24 0x08>;
		clocks = <0x21 0x22 0x17>;
		clock-names = "baud\0bus";
		dmas = <0x47 0x02 0x47 0x03>;
		dma-names = "tx\0rx";
		phandle = <0xaa>;
	};

	pwm@11006000 {
		compatible = "mediatek,pwm";
		reg = <0x00 0x11006000 0x00 0x1000>;
		interrupts = <0x00 0x15 0x08>;
		clocks = <0x22 0x10 0x22 0x11 0x22 0x12 0x22 0x13 0x22 0x14 0x22 0x30 0x22 0x0f 0x22 0x15>;
		clock-names = "PWM1-main\0PWM2-main\0PWM3-main\0PWM4-main\0PWM5-main\0PWM6-main\0PWM-HCLK-main\0PWM-main";
		phandle = <0xab>;
	};

	i2c_common {
		compatible = "mediatek,i2c_common";
		dma_support = [02];
		idvfs = [01];
		set_dt_div = [01];
		check_max_freq = [01];
		ver = [02];
		set_ltiming = [01];
		ext_time_config = [18 01];
		cnt_constraint = [01];
		phandle = <0xac>;
	};

	i2c0@11007000 {
		compatible = "mediatek,i2c";
		id = <0x00>;
		reg = <0x00 0x11007000 0x00 0x1000 0x00 0x11000080 0x00 0x80>;
		interrupts = <0x00 0x1c 0x08>;
		clocks = <0x22 0x0b 0x22 0x26>;
		clock-names = "main\0dma";
		clock-div = <0x05>;
		scl-gpio-id = <0x53>;
		sda-gpio-id = <0x52>;
		gpio_start = <0x10002a00>;
		mem_len = <0x200>;
		eh_cfg = <0x20>;
		pu_cfg = <0x50>;
		rsel_cfg = <0x70>;
		aed = <0x1a>;
		mediatek,hs_only;
		phandle = <0xad>;
	};

	i2c1@11008000 {
		compatible = "mediatek,i2c";
		id = <0x01>;
		reg = <0x00 0x11008000 0x00 0x1000 0x00 0x11000100 0x00 0x80>;
		interrupts = <0x00 0x1d 0x08>;
		clocks = <0x22 0x0b 0x22 0x26>;
		clock-names = "main\0dma";
		clock-div = <0x05>;
		scl-gpio-id = <0x54>;
		sda-gpio-id = <0x51>;
		gpio_start = <0x10002a00>;
		mem_len = <0x200>;
		eh_cfg = <0x20>;
		pu_cfg = <0x50>;
		rsel_cfg = <0x70>;
		aed = <0x1a>;
		mediatek,hs_only;
		phandle = <0xae>;
	};

	i2c2@11009000 {
		compatible = "mediatek,i2c";
		id = <0x02>;
		reg = <0x00 0x11009000 0x00 0x1000 0x00 0x11000180 0x00 0x180>;
		interrupts = <0x00 0x1e 0x08>;
		clocks = <0x22 0x0b 0x22 0x26>;
		clock-names = "main\0dma";
		clock-div = <0x05>;
		scl-gpio-id = <0x67>;
		sda-gpio-id = <0x68>;
		gpio_start = <0x10002800>;
		mem_len = <0x200>;
		eh_cfg = <0x20>;
		pu_cfg = <0x60>;
		rsel_cfg = <0xa0>;
		aed = <0x1a>;
		ch_offset_default = <0x100>;
		ch_offset_ccu = <0x200>;
		mediatek,hs_only;
		phandle = <0xaf>;
	};

	i2c3@1100f000 {
		compatible = "mediatek,i2c";
		id = <0x03>;
		reg = <0x00 0x1100f000 0x00 0x1000 0x00 0x11000300 0x00 0x100>;
		interrupts = <0x00 0x1f 0x08>;
		clocks = <0x22 0x0b 0x22 0x26>;
		clock-names = "main\0dma";
		clock-div = <0x05>;
		scl-gpio-id = <0x32>;
		sda-gpio-id = <0x33>;
		gpio_start = <0x10002600>;
		mem_len = <0x200>;
		eh_cfg = <0x20>;
		pu_cfg = <0x90>;
		rsel_cfg = <0xb0>;
		aed = <0x1a>;
		ch_offset_default = <0x100>;
		mediatek,hs_only;
		phandle = <0xb0>;
	};

	i2c4@11011000 {
		compatible = "mediatek,i2c";
		id = <0x04>;
		reg = <0x00 0x11011000 0x00 0x1000 0x00 0x11000400 0x00 0x180>;
		interrupts = <0x00 0x20 0x08>;
		clocks = <0x22 0x0b 0x22 0x26>;
		clock-names = "main\0dma";
		clock-div = <0x05>;
		scl-gpio-id = <0x69>;
		sda-gpio-id = <0x6a>;
		gpio_start = <0x10002800>;
		mem_len = <0x200>;
		eh_cfg = <0x20>;
		pu_cfg = <0x60>;
		rsel_cfg = <0xa0>;
		aed = <0x1a>;
		ch_offset_default = <0x100>;
		ch_offset_ccu = <0x200>;
		mediatek,hs_only;
		phandle = <0xb1>;
	};

	i2c5@11016000 {
		compatible = "mediatek,i2c";
		id = <0x05>;
		reg = <0x00 0x11016000 0x00 0x1000 0x00 0x11000580 0x00 0x80>;
		interrupts = <0x00 0x4a 0x08>;
		clocks = <0x22 0x0b 0x22 0x26>;
		clock-names = "main\0dma";
		clock-div = <0x05>;
		scl-gpio-id = <0x30>;
		sda-gpio-id = <0x31>;
		gpio_start = <0x10002600>;
		mem_len = <0x200>;
		eh_cfg = <0x20>;
		pu_cfg = <0x90>;
		rsel_cfg = <0xb0>;
		aed = <0x1a>;
		mediatek,hs_only;
		phandle = <0xb2>;
	};

	i2c6@1100d000 {
		compatible = "mediatek,i2c";
		id = <0x06>;
		reg = <0x00 0x1100d000 0x00 0x1000 0x00 0x11000600 0x00 0x80>;
		interrupts = <0x00 0x4b 0x08>;
		clocks = <0x22 0x0b 0x22 0x26>;
		clock-names = "main\0dma";
		clock-div = <0x05>;
		scl-gpio-id = <0xa1>;
		sda-gpio-id = <0xa2>;
		gpio_start = <0x10002c00>;
		mem_len = <0x200>;
		eh_cfg = <0x20>;
		pu_cfg = <0x50>;
		rsel_cfg = <0x70>;
		aed = <0x1a>;
		ch_offset_default = <0x100>;
		ch_offset_ccu = <0x200>;
		mediatek,hs_only;
		phandle = <0xb3>;
	};

	i2c7 {
		phandle = <0xb4>;
	};

	i2c8 {
		phandle = <0xb5>;
	};

	i2c9 {
		phandle = <0xb6>;
	};

	spi0@1100a000 {
		compatible = "mediatek,mt6765-spi";
		mediatek,pad-select = <0x00>;
		reg = <0x00 0x1100a000 0x00 0x1000>;
		interrupts = <0x00 0x3e 0x08>;
		clocks = <0x0f 0x0d 0x0f 0x74 0x22 0x1b>;
		clock-names = "parent-clk\0sel-clk\0spi-clk";
		phandle = <0xb7>;
	};

	therm_ctrl@1100b000 {
		compatible = "mediatek,therm_ctrl";
		reg = <0x00 0x1100b000 0x00 0x1000>;
		interrupts = <0x00 0x16 0x08>;
		clocks = <0x22 0x0a>;
		clock-names = "therm-main";
		nvmem = <0x46>;
		nvmem-names = "mtk_efuse";
		nvmem-cells = <0x48 0x49>;
		nvmem-cell-names = "cpu_freq_segment_cell\0thermal_efuse_cell";
	};

	thermal-sensor1 {
		compatible = "mediatek,mtboard-thermistor1";
		io-channels = <0x38 0x00>;
		io-channel-names = "thermistor-ch0";
		interconnects = <0x38 0x00>;
		phandle = <0xb8>;
	};

	thermal-sensor2 {
		compatible = "mediatek,mtboard-thermistor2";
		io-channels = <0x38 0x01>;
		io-channel-names = "thermistor-ch1";
		interconnects = <0x38 0x01>;
		phandle = <0xb9>;
	};

	thermal-sensor3 {
		compatible = "mediatek,mtboard-thermistor3";
		io-channels = <0x38 0x02>;
		io-channel-names = "thermistor-ch2";
		interconnects = <0x38 0x02>;
		phandle = <0xba>;
	};

	eem_fsm@1100b000 {
		compatible = "mediatek,eem_fsm";
		reg = <0x00 0x1100b000 0x00 0x1000>;
		interrupts = <0x00 0x45 0x08>;
		nvmem = <0x46>;
		nvmem-names = "mtk_efuse";
		nvmem-cells = <0x39>;
		nvmem-cell-names = "efuse_segment_cell";
	};

	btif@1100c000 {
		compatible = "mediatek,btif";
		reg = <0x00 0x1100c000 0x00 0x1000 0x00 0x11000880 0x00 0x80 0x00 0x11000900 0x00 0x80>;
		interrupts = <0x00 0x38 0x08 0x00 0x4c 0x08 0x00 0x4d 0x08>;
		clocks = <0x22 0x1a 0x22 0x26>;
		clock-names = "btifc\0apdmac";
	};

	consys@18002000 {
		compatible = "mediatek,mt6761-consys";
		#address-cells = <0x02>;
		#size-cells = <0x02>;
		reg = <0x00 0x18002000 0x00 0x1000 0x00 0x10007000 0x00 0x100 0x00 0x10001000 0x00 0x1000 0x00 0x10006000 0x00 0x1000 0x00 0x18007000 0x00 0x1000 0x00 0x180b1000 0x00 0x1000 0x00 0x180a3000 0x00 0x1000 0x00 0x180a5000 0x00 0x800 0x00 0x180c1000 0x00 0x1000 0x00 0x18004000 0x00 0x1000>;
		interrupts = <0x00 0xd3 0x08 0x00 0xd5 0x08 0x00 0xd6 0x01>;
		clocks = <0x35 0x01>;
		clock-names = "conn";
		pmic = <0x2d>;
		memory-region = <0x4a>;
		phandle = <0x14>;
	};

	wifi@18000000 {
		compatible = "mediatek,wifi";
		reg = <0x00 0x18000000 0x00 0x100000>;
		interrupts = <0x00 0xd4 0x08>;
		memory-region = <0x4b>;
		phandle = <0xbb>;
	};

	disp_pwm@1100e000 {
		compatible = "mediatek,disp_pwm";
		reg = <0x00 0x1100e000 0x00 0x1000>;
	};

	spi1@11010000 {
		compatible = "mediatek,mt6765-spi";
		mediatek,pad-select = <0x00>;
		reg = <0x00 0x11010000 0x00 0x1000>;
		interrupts = <0x00 0x42 0x08>;
		clocks = <0x0f 0x0d 0x0f 0x74 0x22 0x34>;
		clock-names = "parent-clk\0sel-clk\0spi-clk";
		phandle = <0xbc>;
	};

	spi2@11012000 {
		compatible = "mediatek,mt6765-spi";
		mediatek,pad-select = <0x00>;
		reg = <0x00 0x11012000 0x00 0x1000>;
		interrupts = <0x00 0x48 0x08>;
		clocks = <0x0f 0x0d 0x0f 0x74 0x22 0x37>;
		clock-names = "parent-clk\0sel-clk\0spi-clk";
		phandle = <0xbd>;
	};

	spi3@11013000 {
		compatible = "mediatek,mt6765-spi";
		mediatek,pad-select = <0x00>;
		reg = <0x00 0x11013000 0x00 0x1000>;
		interrupts = <0x00 0x49 0x08>;
		clocks = <0x0f 0x0d 0x0f 0x74 0x22 0x38>;
		clock-names = "parent-clk\0sel-clk\0spi-clk";
		phandle = <0xbe>;
	};

	spi4@11014000 {
		compatible = "mediatek,mt6765-spi";
		mediatek,pad-select = <0x00>;
		reg = <0x00 0x11014000 0x00 0x1000>;
		interrupts = <0x00 0x27 0x08>;
		clocks = <0x0f 0x0d 0x0f 0x74 0x22 0x41>;
		clock-names = "parent-clk\0sel-clk\0spi-clk";
		phandle = <0xbf>;
	};

	spi5@11015000 {
		compatible = "mediatek,mt6765-spi";
		mediatek,pad-select = <0x00>;
		reg = <0x00 0x11015000 0x00 0x1000>;
		interrupts = <0x00 0x28 0x08>;
		clocks = <0x0f 0x0d 0x0f 0x74 0x22 0x42>;
		clock-names = "parent-clk\0sel-clk\0spi-clk";
		phandle = <0xc0>;
	};

	imp_iic@11017000 {
		compatible = "mediatek,imp_iic";
		reg = <0x00 0x11017000 0x00 0x1000>;
	};

	nfi@11018000 {
		compatible = "mediatek,nfi";
		reg = <0x00 0x11018000 0x00 0x1000>;
	};

	nfiecc@11019000 {
		compatible = "mediatek,nfiecc";
		reg = <0x00 0x11019000 0x00 0x1000>;
	};

	usb0@11200000 {
		compatible = "mediatek,mt6761-usb20";
		reg = <0x00 0x11200000 0x00 0x10000 0x00 0x11cc0000 0x00 0x10000>;
		interrupts = <0x00 0x11 0x08>;
		mode = <0x02>;
		multipoint = <0x01>;
		num_eps = <0x10>;
		clocks = <0x22 0x08 0x0f 0x7f 0x0f 0x23>;
		clock-names = "usb0\0usb0_clk_top_sel\0usb0_clk_univpll3_d4";
		pericfg = <0x4c>;
		interrupt-names = "mc";
		phys = <0x4d 0x03>;
		dr_mode = "otg";
		usb-role-switch;
		phandle = <0x64>;
	};

	usb-phy@11210000 {
		compatible = "mediatek,generic-tphy-v1";
		reg = <0x00 0x11cc0000 0x00 0x800>;
		#address-cells = <0x02>;
		#size-cells = <0x02>;
		ranges;
		status = "okay";
		phandle = <0xc1>;

		usb-phy@11210000 {
			reg = <0x00 0x11cc0800 0x00 0x100>;
			clocks = <0x21>;
			clock-names = "ref";
			#phy-cells = <0x01>;
			nvmem-cells = <0x4e>;
			nvmem-cell-names = "intr_cal";
			nvmem-cell-masks = <0x1f>;
			status = "okay";
			phandle = <0x4d>;
		};
	};

	msdc@11230000 {
		compatible = "mediatek,msdc";
		reg = <0x00 0x11230000 0x00 0x10000>;
		interrupts = <0x00 0x17 0x08>;
		index = [00];
		clk_src = [01];
		bus-width = <0x08>;
		max-frequency = <0xbebc200>;
		cap-mmc-highspeed;
		mmc-ddr-1_8v;
		mmc-hs200-1_8v;
		mmc-hs400-1_8v;
		no-sd;
		no-sdio;
		non-removable;
		pinctl = <0x4f>;
		pinctl_hs400 = <0x50>;
		pinctl_hs200 = <0x51>;
		register_setting = <0x52>;
		host_function = [00];
		bootable;
		status = "okay";
		infracfg = <0x22>;
		topckgen = <0x0f>;
		vmmc-supply = <0x53>;
		clocks = <0x22 0x4f 0x22 0x1c 0x22 0x45>;
		clock-names = "msdc0-clock\0msdc0-hclock\0msdc0-aes-clock";
		phandle = <0xc2>;
	};

	msdc@11240000 {
		compatible = "mediatek,msdc";
		reg = <0x00 0x11240000 0x00 0x10000>;
		interrupts = <0x00 0x18 0x08>;
		index = [01];
		clk_src = [02];
		bus-width = <0x04>;
		max-frequency = <0xbebc200>;
		cap-sd-highspeed;
		sd-uhs-sdr12;
		sd-uhs-sdr25;
		sd-uhs-sdr50;
		sd-uhs-sdr104;
		sd-uhs-ddr50;
		no-mmc;
		no-sdio;
		pinctl = <0x54>;
		pinctl_sdr104 = <0x55>;
		pinctl_sdr50 = <0x56>;
		pinctl_ddr50 = <0x57>;
		register_setting = <0x58>;
		host_function = [01];
		cd_level = [01];
		cd-gpios = <0x1e 0x03 0x00>;
		status = "okay";
		vmmc-supply = <0x59>;
		vqmmc-supply = <0x5a>;
		mediatek,pwrap-regmap = <0x12>;
		clocks = <0x22 0x50 0x22 0x1d>;
		clock-names = "msdc1-clock\0msdc1-hclock";
		phandle = <0xc3>;
	};

	msdc@11250000 {
		compatible = "mediatek,msdc2";
		reg = <0x00 0x11250000 0x00 0x10000>;
		status = "disable";
		phandle = <0xc4>;
	};

	msdc@11260000 {
		compatible = "mediatek,msdc3";
		reg = <0x00 0x11250000 0x00 0x10000>;
		status = "disable";
		phandle = <0xc5>;
	};

	msdc1_ins@0 {
		compatible = "mediatek,mt6761-sdcard-ins";
		phandle = <0xc6>;
	};

	msdc0_top@11cd0000 {
		compatible = "mediatek,msdc0_top";
		reg = <0x00 0x11cd0000 0x00 0x1000>;
	};

	msdc1_top@11c90000 {
		compatible = "mediatek,msdc1_top";
		reg = <0x00 0x11c90000 0x00 0x1000>;
	};

	usb1p_sif@11210000 {
		compatible = "mediatek,usb1p_sif";
		reg = <0x00 0x11210000 0x00 0x10000>;
	};

	audclk@11220000 {
		compatible = "mediatek,mt6761-audsys\0syscon";
		reg = <0x00 0x11220000 0x00 0x1000>;
		#clock-cells = <0x01>;
		phandle = <0x5c>;
	};

	audio@11220000 {
		compatible = "mediatek,audio\0syscon";
		reg = <0x00 0x11220000 0x00 0x1000>;
		mediatek,btcvsd_snd = <0x5b>;
		phandle = <0xc7>;
	};

	mt_soc_dl1_pcm@11220000 {
		compatible = "mediatek,mt_soc_pcm_dl1";
		reg = <0x00 0x11220000 0x00 0x1000>;
		interrupts = <0x00 0x61 0x08>;
		clocks = <0x5c 0x00 0x5c 0x04 0x5c 0x05 0x5c 0x03 0x5c 0x01 0x5c 0x02 0x5c 0x06 0x22 0x2b 0x22 0x33 0x0f 0x78 0x0f 0x79 0x0f 0x05 0x0f 0x7a 0x0f 0x2b 0x0f 0x7b 0x0f 0x2e 0x20 0x06 0x21>;
		clock-names = "aud_afe_clk\0aud_dac_clk\0aud_dac_predis_clk\0aud_adc_clk\0aud_apll22m_clk\0aud_apll1_tuner_clk\0aud_tml_clk\0aud_infra_clk\0mtkaif_26m_clk\0top_mux_audio\0top_mux_audio_int\0top_sys_pll1_d4\0top_mux_aud_1\0top_apll1_ck\0top_mux_aud_eng1\0top_apll1_d8\0apmixed_apll1\0top_clk26m_clk";
		phandle = <0xc8>;
	};

	audio_sram@11221000 {
		compatible = "mediatek,audio_sram";
		reg = <0x00 0x11221000 0x00 0x9000>;
	};

	mtk-btcvsd-snd@18050000 {
		compatible = "mediatek,mtk-btcvsd-snd";
		reg = <0x00 0x18050000 0x00 0x1000 0x00 0x18080000 0x00 0x10000>;
		interrupts = <0x00 0xd2 0x08>;
		mediatek,infracfg = <0x22>;
		mediatek,offset = <0xf00 0x800 0x140 0x144 0x148>;
		disable_write_silence = <0x00>;
		phandle = <0x5b>;
	};

	mipi_rx_ana_csi0a@11c10000 {
		compatible = "mediatek,mt6761-mipi0a\0syscon";
		reg = <0x00 0x11c10000 0x00 0x1000>;
		#clock-cells = <0x01>;
		phandle = <0x5f>;
	};

	mipi_rx_ana_csi1@11c20000 {
		compatible = "mediatek,mipi_rx_ana_csi1";
		reg = <0x00 0x11c20000 0x00 0x10000>;
	};

	mipi_rx_ana_csi0b@11c11000 {
		compatible = "mediatek,mt6761-mipi0b\0syscon";
		reg = <0x00 0x11c11000 0x00 0x1000>;
		#clock-cells = <0x01>;
		phandle = <0xc9>;
	};

	mipi_rx_ana_csi1a@11c12000 {
		compatible = "mediatek,mt6761-mipi1a\0syscon";
		reg = <0x00 0x11c12000 0x00 0x1000>;
		#clock-cells = <0x01>;
		phandle = <0xca>;
	};

	mipi_rx_ana_csi1b@11c13000 {
		compatible = "mediatek,mt6761-mipi1b\0syscon";
		reg = <0x00 0x11c13000 0x00 0x1000>;
		#clock-cells = <0x01>;
		phandle = <0xcb>;
	};

	mipi_rx_ana_csi2a@11c14000 {
		compatible = "mediatek,mt6761-mipi2a\0syscon";
		reg = <0x00 0x11c14000 0x00 0x1000>;
		#clock-cells = <0x01>;
		phandle = <0xcc>;
	};

	mipi_rx_ana_csi2b@11c15000 {
		compatible = "mediatek,mt6761-mipi2b\0syscon";
		reg = <0x00 0x11c15000 0x00 0x1000>;
		#clock-cells = <0x01>;
		phandle = <0xcd>;
	};

	mipi_rx_ana_csi2@11c30000 {
		compatible = "mediatek,mipi_rx_ana_csi2";
		reg = <0x00 0x11c30000 0x00 0x10000>;
	};

	efuse@11c50000 {
		compatible = "mediatek,devinfo";
		reg = <0x00 0x11c50000 0x00 0x10000>;
		#address-cells = <0x01>;
		#size-cells = <0x01>;
		phandle = <0x46>;

		segment@78 {
			reg = <0x78 0x04>;
			phandle = <0x39>;
		};

		segment@1c {
			reg = <0x1c 0x04>;
			phandle = <0x48>;
		};

		segment@190 {
			reg = <0x190 0x0c>;
			phandle = <0x49>;
		};

		efuse_analog7@1ac {
			reg = <0x1ac 0x04>;
			phandle = <0xce>;
		};

		u2_phy_data@1ac {
			reg = <0x1ac 0x04>;
			phandle = <0x4e>;
		};
	};

	mipi_tx0@11c80000 {
		compatible = "mediatek,mipi_tx0";
		reg = <0x00 0x11c80000 0x00 0x10000>;
	};

	msdc1_pad_macro@11c90000 {
		compatible = "mediatek,msdc1_pad_macro";
		reg = <0x00 0x11c90000 0x00 0x10000>;
	};

	msdc0_pad_macro@11cd0000 {
		compatible = "mediatek,msdc0_pad_macro";
		reg = <0x00 0x11cd0000 0x00 0x10000>;
	};

	mfg_clark@13000000 {
		compatible = "mediatek,clark";
		reg = <0x00 0x13000000 0x00 0x80000>;
		interrupts = <0x00 0xcb 0x08>;
		interrupt-names = "RGX";
		clock-frequency = <0x21f98280>;
		ged-supply = <0x5d>;
		phandle = <0xcf>;
	};

	mfg_cfg@13ffe000 {
		compatible = "mediatek,mfgcfg\0syscon";
		reg = <0x00 0x13ffe000 0x00 0x1000>;
		#clock-cells = <0x01>;
		phandle = <0xd0>;
	};

	gpufreq {
		compatible = "mediatek,mt6761-gpufreq";
		clocks = <0x0f 0x6d 0x0f 0x28 0x21 0x35 0x07 0x35 0x04 0x35 0x06>;
		clock-names = "clk_mux\0clk_main_parent\0clk_sub_parent\0mtcmos_mfg_async\0mtcmos_mfg\0mtcmos_mfg_core0";
		nvmem-cells = <0x39>;
		nvmem-cell-names = "efuse_segment_cell";
		vcore-supply = <0x37>;
		phandle = <0x5e>;
	};

	ged {
		compatible = "mediatek,ged";
		gpufreq-supply = <0x5e>;
		phandle = <0x5d>;
	};

	mmsys_config@14000000 {
		compatible = "mediatek,mt6761-mmsys_config\0syscon";
		reg = <0x00 0x14000000 0x00 0x1000>;
		interrupts = <0x00 0xab 0x08>;
		#clock-cells = <0x01>;
		phandle = <0x10>;
	};

	dispsys_config@14000000 {
		compatible = "mediatek,mmsys_config\0syscon";
		reg = <0x00 0x14000000 0x00 0x1000>;
		interrupts = <0x00 0xab 0x08>;
		clocks = <0x10 0x17 0x10 0x1a 0x10 0x1b>;
		clock-names = "CAM_MDP\0IMG_DL_RELAY\0IMG_DL_ASYNC_TOP";
		phandle = <0x3a>;
	};

	nfc {
		compatible = "mediatek,nfc-gpio-v2";
		gpio-rst = <0xac>;
		gpio-rst-std = <0x1e 0xac 0x00>;
		gpio-irq = <0x0a>;
		gpio-irq-std = <0x1e 0x0a 0x00>;
		phandle = <0xd1>;
	};

	irq_nfc {
		compatible = "mediatek,irq_nfc-eint";
		phandle = <0xd2>;
	};

	disp_mutex0@14001000 {
		compatible = "mediatek,disp_mutex0";
		reg = <0x00 0x14001000 0x00 0x1000>;
		interrupts = <0x00 0x9a 0x08>;
		phandle = <0x43>;
	};

	smi_common@14002000 {
		compatible = "mediatek,smi_common\0mediatek,mt6761-smi-common";
		reg = <0x00 0x14002000 0x00 0x1000>;
		mmsys_config = <0x3a>;
		clocks = <0x35 0x03 0x10 0x15 0x10 0x16 0x10 0x13>;
		clock-names = "apb\0gals0\0gals1\0smi";
		mediatek,smi-id = <0x03>;
		mediatek,smi-cnt = <0x04>;
		phandle = <0xd3>;
	};

	mmdvfs_pmqos {
		compatible = "mediatek,mmdvfs_pmqos";
		mm_step0 = <0x1b4 0x01 0x00 0x01>;
		mm_step0_ext = <0x1b4 0x02 0x06 0x10c4ec>;
		mm_step1 = <0x138 0x01 0x00 0x02>;
		mm_step1_ext = <0x138 0x02 0x06 0x10c4ec>;
		mm_step2 = <0xe3 0x01 0x00 0x03>;
		mm_step2_ext = <0xe3 0x02 0x06 0x117627>;
		vopp_steps = <0x00 0x01 0x03>;
		disp_freq = "mm_step0\0mm_step1\0mm_step2";
		mdp_freq = "mm_step0\0mm_step1\0mm_step2";
		cam_freq = "mm_step0\0mm_step1\0mm_step2";
		img_freq = "mm_step0\0mm_step1\0mm_step2";
		vdec_freq = "mm_step0\0mm_step1\0mm_step2";
		venc_freq = "mm_step0\0mm_step1\0mm_step2";
		clocks = <0x0f 0x6b 0x0f 0x24 0x0f 0x1a 0x0f 0x25>;
		clock-names = "mmdvfs_clk_mm_sel_ck\0mmdvfs_clk_mmpll_ck\0mmdvfs_clk_univpll1_d2_ck\0mmdvfs_clk_mmpll_d2_ck";
	};

	smi_larb0@14003000 {
		compatible = "mediatek,smi_larb0\0mediatek,smi_larb\0mediatek,mt6761-smi-larb";
		reg = <0x00 0x14003000 0x00 0x1000>;
		mediatek,larb-id = <0x00>;
		clocks = <0x35 0x03 0x10 0x14>;
		clock-names = "apb\0smi";
		mediatek,smi-id = <0x00>;
		phandle = <0x32>;
	};

	mdp_rdma0@14004000 {
		compatible = "mediatek,mdp_rdma0";
		reg = <0x00 0x14004000 0x00 0x1000>;
		interrupts = <0x00 0x9b 0x08>;
		clocks = <0x10 0x00>;
		clock-names = "MDP_RDMA0";
		phandle = <0x3b>;
	};

	mdp_ccorr0@14005000 {
		compatible = "mediatek,mdp_ccorr0";
		reg = <0x00 0x14005000 0x00 0x1000>;
		interrupts = <0x00 0xaa 0x08>;
		clocks = <0x10 0x01>;
		clock-names = "MDP_CCORR";
		phandle = <0x42>;
	};

	mdp_rsz0@14006000 {
		compatible = "mediatek,mdp_rsz0";
		reg = <0x00 0x14006000 0x00 0x1000>;
		interrupts = <0x00 0x9c 0x08>;
		clocks = <0x10 0x02>;
		clock-names = "MDP_RSZ0";
		phandle = <0x3c>;
	};

	mdp_rsz1@14007000 {
		compatible = "mediatek,mdp_rsz1";
		reg = <0x00 0x14007000 0x00 0x1000>;
		interrupts = <0x00 0x9d 0x08>;
		clocks = <0x10 0x03>;
		clock-names = "MDP_RSZ1";
		phandle = <0x3d>;
	};

	mdp_wdma0@14008000 {
		compatible = "mediatek,mdp_wdma0";
		reg = <0x00 0x14008000 0x00 0x1000>;
		interrupts = <0x00 0xa0 0x08>;
		clocks = <0x10 0x06>;
		clock-names = "MDP_WDMA";
		phandle = <0x3e>;
	};

	mdp_wrot0@14009000 {
		compatible = "mediatek,mdp_wrot0";
		reg = <0x00 0x14009000 0x00 0x1000>;
		interrupts = <0x00 0x9f 0x08>;
		clocks = <0x10 0x05>;
		clock-names = "MDP_WROT0";
		phandle = <0x3f>;
	};

	mdp_tdshp0@1400a000 {
		compatible = "mediatek,mdp_tdshp0";
		reg = <0x00 0x1400a000 0x00 0x1000>;
		clocks = <0x10 0x04>;
		clock-names = "MDP_TDSHP";
		phandle = <0x40>;
	};

	disp_ovl0@1400b000 {
		compatible = "mediatek,disp_ovl0";
		reg = <0x00 0x1400b000 0x00 0x1000>;
		interrupts = <0x00 0xa1 0x08>;
	};

	disp_ovl0_2l@1400c000 {
		compatible = "mediatek,disp_ovl0_2l";
		reg = <0x00 0x1400c000 0x00 0x1000>;
		interrupts = <0x00 0xad 0x08>;
	};

	disp_rdma0@1400d000 {
		compatible = "mediatek,disp_rdma0";
		reg = <0x00 0x1400d000 0x00 0x1000>;
		interrupts = <0x00 0xa2 0x08>;
	};

	disp_wdma0@1400e000 {
		compatible = "mediatek,disp_wdma0";
		reg = <0x00 0x1400e000 0x00 0x1000>;
		interrupts = <0x00 0xa3 0x08>;
	};

	disp_color0@1400f000 {
		compatible = "mediatek,disp_color0";
		reg = <0x00 0x1400f000 0x00 0x1000>;
		interrupts = <0x00 0xa4 0x08>;
		phandle = <0x41>;
	};

	disp_ccorr0@14010000 {
		compatible = "mediatek,disp_ccorr0";
		reg = <0x00 0x14010000 0x00 0x1000>;
		interrupts = <0x00 0xa5 0x08>;
	};

	disp_aal0@14011000 {
		compatible = "mediatek,disp_aal0";
		reg = <0x00 0x14011000 0x00 0x1000>;
		interrupts = <0x00 0xa6 0x08>;
	};

	disp_gamma0@14012000 {
		compatible = "mediatek,disp_gamma0";
		reg = <0x00 0x14012000 0x00 0x1000>;
		interrupts = <0x00 0xa7 0x08>;
	};

	disp_dither0@14013000 {
		compatible = "mediatek,disp_dither0";
		reg = <0x00 0x14013000 0x00 0x1000>;
		interrupts = <0x00 0xa8 0x08>;
	};

	dsi0@14014000 {
		compatible = "mediatek,dsi0";
		reg = <0x00 0x14014000 0x00 0x1000>;
		interrupts = <0x00 0xa9 0x08>;
	};

	disp_rsz0@14015000 {
		compatible = "mediatek,disp_rsz0";
		reg = <0x00 0x14015000 0x00 0x1000>;
		interrupts = <0x00 0xdc 0x08>;
	};

	mtkfb@0 {
		compatible = "mediatek,mtkfb";
		phandle = <0xd4>;
	};

	dispsys {
		compatible = "mediatek,dispsys";
		mediatek,larb = <0x32>;
		clocks = <0x35 0x03 0x10 0x13 0x10 0x14 0x10 0x15 0x10 0x16 0x10 0x07 0x10 0x08 0x10 0x0a 0x10 0x0b 0x10 0x0c 0x10 0x0d 0x10 0x0e 0x10 0x0f 0x10 0x10 0x10 0x11 0x10 0x1c 0x10 0x1d 0x10 0x09 0x20 0x13 0x0f 0x7c 0x22 0x31 0x21 0x0f 0x1e 0x0f 0x2f 0x0f 0x31>;
		clock-names = "MMSYS_MTCMOS\0MMSYS_SMI_COMMON\0MMSYS_SMI_LARB0\0MMSYS_GALS_COMM0\0MMSYS_GALS_COMM1\0MMSYS_DISP_OVL0\0MMSYS_DISP_OVL0_2L\0MMSYS_DISP_RDMA0\0MMSYS_DISP_WDMA0\0MMSYS_DISP_COLOR0\0MMSYS_DISP_CCORR0\0MMSYS_DISP_AAL0\0MMSYS_DISP_GAMMA0\0MMSYS_DISP_DITHER0\0MMSYS_DSI0_MM_CK\0MMSYS_DSI0_IF_CK\0MMSYS_26M\0MMSYS_DISP_RSZ0\0APMIXED_MIPI_26M\0TOP_MUX_DISP_PWM\0DISP_PWM\0TOP_26M\0TOP_UNIVPLL2_D4\0TOP_ULPOSC1_D2\0TOP_ULPOSC1_D8";
	};

	dsi_te {
		compatible = "mediatek, DSI_TE-eint";
		status = "disabled";
		phandle = <0xd5>;
	};

	mm_mutex@14016000 {
		compatible = "mediatek,mm_mutex";
		reg = <0x00 0x14016000 0x00 0x1000>;
		phandle = <0xd6>;
	};

	camsys@15000000 {
		compatible = "mediatek,mt6761-camsys\0syscon";
		reg = <0x00 0x15000000 0x00 0x1000>;
		#clock-cells = <0x01>;
		phandle = <0x11>;
	};

	ispsys@15000000 {
		compatible = "mediatek,mt6761-ispsys";
		reg = <0x00 0x15004000 0x00 0x9000 0x00 0x1500d000 0x00 0x1000 0x00 0x15000000 0x00 0x52000 0x00 0x15040000 0x00 0x8000 0x00 0x10215000 0x00 0x3000 0x00 0x10211000 0x00 0x1000>;
		interrupts = <0x00 0xb3 0x08 0x00 0xb4 0x08 0x00 0xb5 0x08 0x00 0xb8 0x08 0x00 0xb9 0x08 0x00 0xba 0x08 0x00 0xbb 0x08>;
		clocks = <0x35 0x03 0x35 0x08 0x11 0x00 0x11 0x01 0x11 0x02 0x11 0x03 0x11 0x04 0x11 0x05 0x10 0x15 0x10 0x16 0x10 0x13>;
		clock-names = "CG_SCP_SYS_DIS\0CG_SCP_SYS_CAM\0CG_CAM_LARB2\0CG_CAM\0CG_CAMTG\0CG_CAM_SENINF\0CG_CAMSV0\0CG_CAMSV1\0CG_MM_SMI_COMM0\0CG_MM_SMI_COMM1\0CG_MM_SMI_COMMON";
	};

	smi_larb2@15001000 {
		compatible = "mediatek,smi_larb2\0mediatek,smi_larb\0mediatek,mt6761-smi-larb";
		reg = <0x00 0x15001000 0x00 0x1000>;
		mediatek,larb-id = <0x02>;
		clocks = <0x35 0x08 0x10 0x18 0x11 0x00>;
		clock-names = "apb\0gals\0smi";
		mediatek,smi-id = <0x02>;
		phandle = <0x34>;
	};

	cam@15004000 {
		compatible = "mediatek,cam";
		reg = <0x00 0x15004000 0x00 0x1000>;
	};

	cam_lut@15005000 {
		compatible = "mediatek,cam_lut";
		reg = <0x00 0x15005000 0x00 0x1000>;
	};

	camd@15006000 {
		compatible = "mediatek,camd";
		reg = <0x00 0x15006000 0x00 0x1000>;
	};

	cam_dma@15007000 {
		compatible = "mediatek,cam_dma";
		reg = <0x00 0x15007000 0x00 0x1000>;
	};

	fdvt@1500b000 {
		compatible = "mediatek,fdvt";
		reg = <0x00 0x1500b000 0x00 0x1000>;
		interrupts = <0x00 0xb6 0x08>;
		clocks = <0x11 0x06>;
		clock-names = "FD_CLK_CAM_FDVT";
	};

	cam_inner@1500d000 {
		compatible = "mediatek,cam_inner";
		reg = <0x00 0x1500d000 0x00 0x1000>;
	};

	camd_inner@1500e000 {
		compatible = "mediatek,camd_inner";
		reg = <0x00 0x1500e000 0x00 0x1000>;
	};

	cam_inner_dma@1500f000 {
		compatible = "mediatek,cam_inner_dma";
		reg = <0x00 0x1500f000 0x00 0x1000>;
	};

	camsv0@15050000 {
		compatible = "mediatek,camsv0";
		reg = <0x00 0x15050000 0x00 0x1000>;
	};

	camsv1@15051000 {
		compatible = "mediatek,camsv1";
		reg = <0x00 0x15051000 0x00 0x1000>;
	};

	kd_camera_hw1@15040000 {
		compatible = "mediatek,camera_hw";
		reg = <0x00 0x15040000 0x00 0x1000>;
		clocks = <0x0f 0x6f 0x0f 0x70 0x0f 0x71 0x0f 0x72 0x0f 0x16 0x0f 0x15 0x0f 0x20 0x0f 0x13 0x0f 0x1f 0x0f 0x14 0x21 0x11 0x03 0x20 0x0c 0x20 0x10 0x5f 0x00 0x0f 0x86 0x0f 0x1d 0x35 0x08>;
		clock-names = "CLK_TOP_CAMTG_SEL\0CLK_TOP_CAMTG1_SEL\0CLK_TOP_CAMTG2_SEL\0CLK_TOP_CAMTG3_SEL\0CLK_MCLK_6M\0CLK_MCLK_12M\0CLK_MCLK_13M\0CLK_MCLK_48M\0CLK_MCLK_52M\0CLK_MCLK_24M\0CLK_MCLK_26M\0CLK_CAM_SENINF_CG\0CLK_MIPI_C0_26M_CG\0CLK_MIPI_C1_26M_CG\0CLK_MIPI_ANA_0A_CG\0CLK_TOP_CAMTM_SEL_CG\0CLK_TOP_CAMTM_208_CG\0CLK_SCP_SYS_CAM";
		phandle = <0xd7>;
	};

	camera_af_hw_node {
		compatible = "mediatek,camera_af_lens";
		camaf_m1_pmic-supply = <0x60>;
		phandle = <0xd8>;
	};

	flashlight_core {
		compatible = "mediatek,flashlight_core";
		phandle = <0xd9>;
	};

	host_power {
		compatible = "mediatek,host_power";
		phandle = <0xda>;
	};

	icnfpsensor@0 {
		compatible = "mediatek,icnfpsensor";
		phandle = <0xdb>;
	};

	flashlights_mt6370 {
		compatible = "mediatek,flashlights_mt6370";
		decouple = <0x00>;
		phandle = <0xdc>;

		channel@1 {
			type = <0x00>;
			ct = <0x00>;
			part = <0x00>;
		};

		channel@2 {
			type = <0x00>;
			ct = <0x01>;
			part = <0x00>;
		};
	};

	vcodecsys@17000000 {
		compatible = "mediatek,mt6761-vcodecsys\0syscon";
		reg = <0x00 0x17000000 0x00 0x10000>;
		#clock-cells = <0x01>;
		phandle = <0x61>;
	};

	venc_gcon@17000000 {
		compatible = "mediatek,venc_gcon\0syscon";
		reg = <0x00 0x17000000 0x00 0x10000>;
		clocks = <0x35 0x03 0x35 0x09 0x10 0x15 0x10 0x16 0x10 0x13 0x61 0x03 0x61 0x01>;
		clock-names = "MT_SCP_SYS_DIS\0MT_SCP_SYS_VCODEC\0MT_CG_MM_SMI_COMM0\0MT_CG_MM_SMI_COMM1\0MT_CG_MM_SMI_COMMON\0MT_CG_VDEC\0MT_CG_VENC";
		phandle = <0xdd>;
	};

	smi_larb1@17010000 {
		compatible = "mediatek,smi_larb1\0mediatek,smi_larb\0mediatek,mt6761-smi-larb";
		reg = <0x00 0x17010000 0x00 0x1000>;
		mediatek,larb-id = <0x01>;
		clocks = <0x35 0x09 0x61 0x01>;
		clock-names = "apb\0smi";
		mediatek,smi-id = <0x01>;
		phandle = <0x33>;
	};

	venc@17020000 {
		compatible = "mediatek,venc";
		reg = <0x00 0x17020000 0x00 0x10000>;
		interrupts = <0x00 0xae 0x08>;
	};

	venc_jpg@17030000 {
		compatible = "mediatek,venc_jpg";
		reg = <0x00 0x17030000 0x00 0x10000>;
		interrupts = <0x00 0xb0 0x08>;
		clocks = <0x61 0x02>;
		clock-names = "MT_CG_VENC_JPGENC";
	};

	vdec@17040000 {
		compatible = "mediatek,vdec";
		reg = <0x00 0x17040000 0x00 0x10000>;
		interrupts = <0x00 0xb1 0x08>;
	};

	mbist@17050000 {
		compatible = "mediatek,mbist";
		reg = <0x00 0x17050000 0x00 0x10000>;
	};

	otg_iddig {
		compatible = "mediatek,usb_iddig_bi_eint";
		phandle = <0xde>;
	};

	odm {
		compatible = "simple-bus";
		phandle = <0xdf>;
	};

	memory-ssmr-features {
		compatible = "mediatek,memory-ssmr-features";
		svp-region-based-size = <0x00 0x10000000>;
		phandle = <0xe0>;
	};

	audio_snd_card {
		compatible = "mediatek,audio_snd_card";
	};

	mt_soc_deep_buffer_dl_pcm {
		compatible = "mediatek,mt_soc_pcm_deep_buffer_dl";
	};

	mt_soc_ul1_pcm {
		compatible = "mediatek,mt_soc_pcm_capture";
	};

	mt_soc_voice_md1 {
		compatible = "mediatek,mt_soc_pcm_voice_md1";
	};

	mt_soc_uldlloopback_pcm {
		compatible = "mediatek,mt_soc_pcm_uldlloopback";
	};

	mt_soc_i2s0_pcm {
		compatible = "mediatek,mt_soc_pcm_dl1_i2s0";
	};

	mt_soc_mrgrx_pcm {
		compatible = "mediatek,mt_soc_pcm_mrgrx";
	};

	mt_soc_mrgrx_awb_pcm {
		compatible = "mediatek,mt_soc_pcm_mrgrx_awb";
	};

	mt_soc_fm_i2s_pcm {
		compatible = "mediatek,mt_soc_pcm_fm_i2s";
	};

	mt_soc_fm_i2s_awb_pcm {
		compatible = "mediatek,mt_soc_pcm_fm_i2s_awb";
	};

	mt_soc_i2s0dl1_pcm {
		compatible = "mediatek,mt_soc_pcm_dl1_i2s0dl1";
	};

	mt_soc_dl1_awb_pcm {
		compatible = "mediatek,mt_soc_pcm_dl1_awb";
	};

	mt_soc_voice_md1_bt {
		compatible = "mediatek,mt_soc_pcm_voice_md1_bt";
	};

	mt_soc_voip_bt_out {
		compatible = "mediatek,mt_soc_pcm_dl1_bt";
	};

	mt_soc_voip_bt_in {
		compatible = "mediatek,mt_soc_pcm_bt_dai";
	};

	mt_soc_tdmrx_pcm {
		compatible = "mediatek,mt_soc_tdm_capture";
	};

	mt_soc_fm_mrgtx_pcm {
		compatible = "mediatek,mt_soc_pcm_fmtx";
	};

	mt_soc_ul2_pcm {
		compatible = "mediatek,mt_soc_pcm_capture2";
	};

	mt_soc_i2s0_awb_pcm {
		compatible = "mediatek,mt_soc_pcm_i2s0_awb";
	};

	mt_soc_voice_md2 {
		compatible = "mediatek,mt_soc_pcm_voice_md2";
	};

	mt_soc_pcm_dl1_scp_spk {
		compatible = "mediatek,mt_soc_pcm_dl1_scp_spk";
	};

	mt_soc_pcm_voice_scp {
		compatible = "mediatek,mt_soc_pcm_voice_scp";
	};

	mt_soc_routing_pcm {
		compatible = "mediatek,mt_soc_pcm_routing";
	};

	mt_soc_voice_md2_bt {
		compatible = "mediatek,mt_soc_pcm_voice_md2_bt";
	};

	mt_soc_hp_impedance_pcm {
		compatible = "mediatek,mt_soc_pcm_hp_impedance";
	};

	mt_soc_dummy_pcm {
		compatible = "mediatek,mt_soc_pcm_dummy";
	};

	mt_soc_codec_dummy_name {
		compatible = "mediatek,mt_soc_codec_dummy";
	};

	mt_soc_routing_dai_name {
		compatible = "mediatek,mt_soc_dai_routing";
	};

	mt_soc_dai_name {
		compatible = "mediatek,mt_soc_dai_stub";
	};

	mt_soc_dl2_pcm {
		compatible = "mediatek,mt_soc_pcm_dl2";
	};

	mt_soc_anc_pcm {
		compatible = "mediatek,mt_soc_pcm_anc";
	};

	mt_soc_pcm_voice_ultra {
		compatible = "mediatek,mt_soc_pcm_voice_ultra";
	};

	mt_soc_pcm_voice_usb {
		compatible = "mediatek,mt_soc_pcm_voice_usb";
	};

	mt_soc_pcm_voice_usb_echoref {
		compatible = "mediatek,mt_soc_pcm_voice_usb_echoref";
	};

	lk_charger {
		compatible = "mediatek,lk_charger";
		enable_anime;
		enable_pe_plus;
		enable_pd20_reset;
		power_path_support;
		max_charger_voltage = <0x989680>;
		fast_charge_voltage = <0x2dc6c0>;
		usb_charger_current = <0x2dc6c0>;
		ac_charger_current = <0x1e3660>;
		ac_charger_input_current = <0x1f47d0>;
		non_std_ac_charger_current = <0x1e3660>;
		charging_host_charger_current = <0x16e360>;
		ta_ac_charger_current = <0x2dc6c0>;
		pd_charger_current = <0x2dc6c0>;
		temp_t4_threshold = <0x32>;
		temp_t3_threshold = <0x2d>;
		temp_t1_threshold = <0x00>;
		phandle = <0xe1>;
	};

	pe {
		compatible = "mediatek,charger,pe";
		gauge = <0x62>;
		ta_9v_support;
		pe_ichg_level_threshold = <0x2dc6c0>;
		ta_start_battery_soc = <0x00>;
		ta_stop_battery_soc = <0x55>;
		min_charger_voltage = <0x4630c0>;
		ta_ac_12v_input_current = <0x30d400>;
		ta_ac_9v_input_current = <0x30d400>;
		ta_ac_7v_input_current = <0x30d400>;
		pe_charger_current = <0x2dc6c0>;
		phandle = <0xe2>;
	};

	pe2 {
		compatible = "mediatek,charger,pe2";
		gauge = <0x62>;
		pe20_ichg_level_threshold = <0xf4240>;
		ta_start_battery_soc = <0x00>;
		ta_stop_battery_soc = <0x55>;
		min_charger_voltage = <0x4630c0>;
		cable_imp_threshold = <0x2bb>;
		vbat_cable_imp_threshold = <0x3b8260>;
		sc_input_current = <0x30d400>;
		sc_charger_current = <0x2dc6c0>;
		dcs_input_current = <0x30d400>;
		dcs_chg1_charger_current = <0x2dc6c0>;
		dcs_chg2_charger_current = <0x2dc6c0>;
		dual_polling_ieoc = <0x6ddd0>;
		slave_mivr_diff = <0x186a0>;
		phandle = <0xe3>;
	};

	pdc {
		compatible = "mediatek,charger,pd";
		gauge = <0x62>;
		min_charger_voltage = <0x4630c0>;
		pd_vbus_low_bound = <0x4c4b40>;
		pd_vbus_upper_bound = <0x4c4b40>;
		vsys_watt = <0x4c4b40>;
		ibus_err = <0x0e>;
		pd_stop_battery_soc = <0x50>;
		sc_input_current = <0x30d400>;
		sc_charger_current = <0x2dc6c0>;
		dcs_input_current = <0x30d400>;
		dcs_chg1_charger_current = <0x2dc6c0>;
		dcs_chg2_charger_current = <0x2dc6c0>;
		dual_polling_ieoc = <0x6ddd0>;
		slave_mivr_diff = <0x186a0>;
		phandle = <0xe4>;
	};

	pe4 {
		compatible = "mediatek,charger,pe4";
		gauge = <0x62>;
		min_charger_voltage = <0x4630c0>;
		pe40_stop_battery_soc = <0x50>;
		high_temp_to_leave_pe40 = <0x2e>;
		high_temp_to_enter_pe40 = <0x27>;
		low_temp_to_leave_pe40 = <0x0a>;
		low_temp_to_enter_pe40 = <0x10>;
		ibus_err = <0x0e>;
		pe40_r_cable_1a_lower = <0x1f4>;
		pe40_r_cable_2a_lower = <0x15f>;
		pe40_r_cable_3a_lower = <0xf0>;
		sc_input_current = <0x30d400>;
		sc_charger_current = <0x2dc6c0>;
		dcs_input_current = <0x30d400>;
		dcs_chg1_charger_current = <0x2dc6c0>;
		dcs_chg2_charger_current = <0x2dc6c0>;
		dual_polling_ieoc = <0x6ddd0>;
		slave_mivr_diff = <0x186a0>;
		phandle = <0xe5>;
	};

	charger {
		compatible = "mediatek,charger";
		gauge = <0x62>;
		charger = <0x27>;
		bootmode = <0x28>;
		pmic = <0x2d>;
		algorithm_name = "Basic";
		charger_configuration = <0x00>;
		battery_cv = <0x426030>;
		max_charger_voltage = <0x989680>;
		min_charger_voltage = <0x432380>;
		jeita_temp_above_t4_cv = <0x40b280>;
		jeita_temp_t3_to_t4_cv = <0x40b280>;
		jeita_temp_t2_to_t3_cv = <0x423920>;
		jeita_temp_t1_to_t2_cv = <0x40b280>;
		jeita_temp_t0_to_t1_cv = <0x3da540>;
		jeita_temp_below_t0_cv = <0x3da540>;
		temp_t4_thres = <0x32>;
		temp_t4_thres_minus_x_degree = <0x2f>;
		temp_t3_thres = <0x2d>;
		temp_t3_thres_minus_x_degree = <0x27>;
		temp_t2_thres = <0x0a>;
		temp_t2_thres_plus_x_degree = <0x10>;
		temp_t1_thres = <0x00>;
		temp_t1_thres_plus_x_degree = <0x06>;
		temp_t0_thres = <0x00>;
		temp_t0_thres_plus_x_degree = <0x00>;
		temp_neg_10_thres = <0x00>;
		enable_min_charge_temp;
		min_charge_temp = <0x00>;
		min_charge_temp_plus_x_degree = <0x06>;
		max_charge_temp = <0x32>;
		max_charge_temp_minus_x_degree = <0x2f>;
		usb_charger_current = <0x7a120>;
		ac_charger_current = <0x1e3660>;
		ac_charger_input_current = <0x1f47d0>;
		charging_host_charger_current = <0x16e360>;
		enable_dynamic_mivr;
		min_charger_voltage_1 = <0x432380>;
		min_charger_voltage_2 = <0x401640>;
		max_dmivr_charger_current = <0x1e8480>;
		phandle = <0x2c>;
	};

	pd_adapter {
		compatible = "mediatek,pd_adapter";
		adapter_name = "pd_adapter";
		phandle = <0xe6>;
	};

	extcon_usb {
		compatible = "mediatek,extcon-usb";
		charger = <0x27>;
		vbus-supply = <0x63>;
		vbus-voltage = <0x4c4b40>;
		vbus-current = <0x1b7740>;
		dev-conn = <0x64>;
		mediatek,bypss-typec-sink = <0x01>;
		phandle = <0xe7>;
	};

	rt9465_slave_chr {
		compatible = "richtek,rt9465";
		status = "disabled";
		phandle = <0xe8>;
	};

	ssmr {
		compatible = "mediatek,trusted_mem";
		memory-region = <0x65>;
	};

	rt-pd-manager {
		compatible = "mediatek,rt-pd-manager";
	};

	mt6370_pmu_eint {
		phandle = <0xe9>;
	};

	pmic_clock_buffer_ctrl {
		compatible = "mediatek,pmic_clock_buffer";
		mediatek,clkbuf-quantity = <0x07>;
		mediatek,clkbuf-config = <0x02 0x01 0x01 0x02 0x00 0x00 0x00>;
		mediatek,clkbuf-driving-current = <0x01 0x01 0x01 0x01 0x01 0x01 0x01>;
		mediatek,bblpm-support = "enable";
		pwrap-dcxo-en = <0x188 0x00 0x188 0x01 0x188 0x00>;
		pwrap-dcxo-cfg = <0x18c 0x19c>;
		spm-pwr-status = <0x180 0x00 0x180 0x01>;
		pwrap = <0x12>;
		sleep = <0x66>;
		phandle = <0xea>;
	};

	pbm {
		compatible = "mediatek,pbm";
		io-channels = <0x23 0x00>;
		io-channel-names = "pmic_batadc";
		phandle = <0xeb>;
	};

	battery {
		compatible = "mediatek,bat_gm30";
		phandle = <0xec>;
	};

	iommu_test {
		compatible = "mediatek,ktf-iommu-test";
		iommus = <0x67 0x02>;
	};

	pseudo_m4u {
		compatible = "mediatek,mt-pseudo_m4u";
		iommus = <0x67 0x02>;
	};

	pseudo_m4u-larb0 {
		compatible = "mediatek,mt-pseudo_m4u-port";
		mediatek,larbid = <0x00>;
		iommus = <0x67 0x00 0x67 0x01 0x67 0x02 0x67 0x03 0x67 0x04 0x67 0x05 0x67 0x06 0x67 0x07>;
	};

	pseudo_m4u-larb1 {
		compatible = "mediatek,mt-pseudo_m4u-port";
		mediatek,larbid = <0x01>;
		iommus = <0x67 0x20 0x67 0x21>;
	};

	pseudo_m4u-larb2 {
		compatible = "mediatek,mt-pseudo_m4u-port";
		mediatek,larbid = <0x02>;
		iommus = <0x67 0x40 0x67 0x41>;
	};

	radio_md_cfg {
		compatible = "mediatek,radio_md_cfg";
		phandle = <0xed>;
	};

	dynamic_options {
		compatible = "mediatek,dynamic_options";
		phandle = <0xee>;
	};

	cm_mgr@10200000 {
		compatible = "mediatek,mt6761-cm_mgr";
		reg = <0x00 0x10200000 0x00 0x4000>;
		reg-names = "cm_mgr_base";
		required-opps = <0x2e 0x2f 0x30>;
		cm_mgr,cp_down = <0x64 0x64>;
		cm_mgr,cp_up = <0x64 0x64>;
		cm_mgr,dt_down = <0x00 0x03>;
		cm_mgr,dt_up = <0x00 0x03>;
		cm_mgr,vp_down = <0x64 0x64>;
		cm_mgr,vp_up = <0x64 0x64>;
		use_cpu_to_dram_map = "enable";
		cm_mgr_cpu_opp_to_dram = <0x00 0x00 0x00 0x00 0x01 0x01 0x01 0x01 0x01 0x02 0x02 0x02 0x02 0x02 0x02 0x02>;
		phandle = <0xef>;
	};

	dram_ctrl {
		compatible = "mediatek,dram-qosctrl";
		required-opps = <0x2e 0x2f>;
	};

	mt6370_pmu_dts {
		interrupt-controller;
		#interrupt-cells = <0x01>;
		mt6370,intr_gpio_num = <0x03>;
		mt6370,intr_gpio = <0x1e 0x03 0x00>;
		phandle = <0xf0>;

		core {
			compatible = "mediatek,mt6370_pmu_core";
			interrupt-names = "otp\0vdda_ovp\0vdda_uv";
			i2cstmr_rst_tmr = <0x00>;
			mrstb_en;
			mrstb_tmr = <0x03>;
			int_wdt = <0x00>;
			int_deg = <0x00>;
		};

		charger {
			compatible = "mediatek,mt6370_pmu_charger";
			interrupt-names = "chg_mivr\0chg_aiclmeasi\0attachi\0ovpctrl_uvp_d_evt\0chg_wdtmri\0chg_vbusov\0chg_tmri\0chg_treg\0dcdti";
			bootmode = <0x28>;
			charger_name = "primary_chg";
			load_switch_name = "primary_load_switch";
			ichg = <0x1e8480>;
			aicr = <0x7a120>;
			mivr = <0x432380>;
			cv = <0x43e6d0>;
			ieoc = <0x249f0>;
			safety_timer = <0x0c>;
			dc_wdt = <0x3d0900>;
			ircmp_resistor = <0x61a8>;
			ircmp_vclamp = <0x7d00>;
			enable_te;
			enable_wdt;
			enable_otg_wdt;
			lbp_hys_sel = <0x01>;
			lbp_dt = <0x01>;
			charger = <0x27>;
			bc12_sel = <0x00>;
			phandle = <0x27>;

			usb-otg-vbus {
				regulator-compatible = "usb-otg-vbus";
				regulator-name = "usb-otg-vbus";
				regulator-min-microvolt = <0x426030>;
				regulator-max-microvolt = <0x588040>;
				regulator-min-microamp = <0x7a120>;
				regulator-max-microamp = <0x2dc6c0>;
				phandle = <0x63>;
			};
		};

		mt6370_pmu_fled1 {
			compatible = "mediatek,mt6370_pmu_fled1";
			interrupt-names = "fled_lvf\0fled2_short\0fled1_short";
			fled_enable = <0x01>;
			torch_cur = <0x493e0>;
			strobe_cur = <0x124f80>;
			strobe_timeout = <0x960>;
		};

		mt6370_pmu_fled2 {
			compatible = "mediatek,mt6370_pmu_fled2";
			fled_enable = <0x01>;
			torch_cur = <0x30d40>;
			strobe_cur = <0xf4240>;
			strobe_timeout = <0x4b0>;
		};

		ldo {
			compatible = "mediatek,mt6370_pmu_ldo";
			interrupt-names = "ldo_oc";
			ldo_oms = <0x01>;
			ldo_vrc_lt = <0x01>;

			mt6370_ldo {
				regulator-name = "irtx_ldo";
				regulator-min-microvolt = <0x186a00>;
				regulator-max-microvolt = <0x3d0900>;
			};
		};

		rgbled {
			compatible = "mediatek,mt6370_pmu_rgbled";
			interrupt-names = "isink4_short\0isink3_short\0isink2_short\0isink1_short\0isink4_open\0isink3_open\0isink2_open\0isink1_open";
			mt,led_name = "red\0green\0blue\0mt6370_pmu_led4";
			mt,led_default_trigger = "pwm_mode\0pwm_mode\0pwm_mode\0pwm_mode";
		};

		bled {
			compatible = "mediatek,mt6370_pmu_bled";
			interrupt-names = "bled_ocp";
			mt,bled_name = "mt6370_pmu_bled";
			mt,chan_en = <0x0f>;
			mt,map_linear;
			mt,bl_ovp_level = <0x03>;
			mt,bl_ocp_level = <0x02>;
			mt,use_pwm;
			mt,pwm_fsample = <0x02>;
			mt,pwm_deglitch = <0x01>;
			mt,pwm_hys_en = <0x01>;
			mt,pwm_hys = <0x00>;
			mt,pwm_avg_cycle = <0x00>;
			mt,bled_ramptime = <0x03>;
			mt,bled_flash_ramp = <0x01>;
			mt,max_bled_brightness = <0xcd>;
			mt,bled_curr_scale = <0x00>;
			mt,pwm_lpf_coef = <0x00>;
		};

		dsv {
			compatible = "mediatek,mt6370_pmu_dsv";
			interrupt-names = "dsv_vneg_ocp\0dsv_vpos_ocp\0dsv_bst_ocp\0dsv_vneg_scp\0dsv_vpos_scp";
			db_ext_en = <0x00>;
			db_periodic_fix = <0x00>;
			db_single_pin = <0x00>;
			db_freq_pm = <0x00>;
			db_periodic_mode = <0x00>;
			db_startup = <0x00>;
			db_vneg_20ms = <0x01>;
			db_vneg_disc = <0x00>;
			db_vpos_20ms = <0x01>;
			db_vpos_disc = <0x01>;
			db_delay = <0x03>;
			db_vbst = <0x1644>;
			db_vpos_slew = <0x01>;
			db_vneg_slew = <0x01>;

			mt6370_dsvp {
				regulator-name = "dsv_pos";
				regulator-min-microvolt = <0x3d0900>;
				regulator-max-microvolt = <0x5b8d80>;
			};

			mt6370_dsvn {
				regulator-name = "dsv_neg";
				regulator-min-microvolt = <0x3d0900>;
				regulator-max-microvolt = <0x5b8d80>;
			};
		};
	};

	type_c_port0 {
		mt-tcpc,name = "type_c_port0";
		mt-tcpc,role_def = <0x05>;
		mt-tcpc,rp_level = <0x01>;
		mt-tcpc,vconn_supply = <0x01>;
		mt-tcpc,notifier_supply_num = <0x02>;
		mt6370pd,intr_gpio = <0x1e 0x18 0x00>;
		mt6370pd,intr_gpio_num = <0x18>;
		charger = <0x27>;
		phandle = <0xf1>;

		pd-data {
			pd,vid = <0x29cf>;
			pd,pid = <0x5081>;
			pd,source-cap-ext = <0x508129cf 0x00 0x00 0x00 0x00 0x7000000>;
			pd,mfrs = "RichtekTCPC";
			pd,charging_policy = <0x31>;
			pd,source-pdo-size = <0x01>;
			pd,source-pdo-data = <0x19096>;
			pd,sink-pdo-size = <0x01>;
			pd,sink-pdo-data = <0x190c8>;
			pd,id-vdo-size = <0x06>;
			pd,id-vdo-data = <0xd14029cf 0x00 0x50810000 0x41800000 0x00 0x21800000>;
			bat,nr = <0x01>;
			pd,country_nr = <0x00>;

			bat-info0 {
				bat,vid = <0x29cf>;
				bat,pid = <0x5081>;
				bat,mfrs = "bat1";
				bat,design_cap = <0xbb8>;
			};
		};

		dpm_caps {
			local_dr_power;
			local_dr_data;
			local_usb_comm;
			local_no_suspend;
			local_vconn_supply;
			attemp_enter_dp_mode;
			attemp_discover_cable;
			attemp_discover_id;
			pr_check = <0x00>;
			dr_check = <0x00>;
		};

		displayport {
			1st_connection = "dfp_d";
			2nd_connection = "dfp_d";
			signal,dp_v13;
			typec,receptacle;

			ufp_d {
			};

			dfp_d {
				pin_assignment,mode_c;
				pin_assignment,mode_d;
				pin_assignment,mode_e;
			};
		};
	};

	__symbols__ {
		chosen = "/chosen";
		cluster0_opp = "/opp_table0";
		cpu0 = "/cpus/cpu@000";
		cpu1 = "/cpus/cpu@001";
		cpu2 = "/cpus/cpu@002";
		cpu3 = "/cpus/cpu@003";
		STANDBY = "/cpus/idle-states/standby";
		MCDI_CPU = "/cpus/idle-states/mcdi-cpu";
		MCDI_CLUSTER = "/cpus/idle-states/mcdi-cluster";
		SODI = "/cpus/idle-states/sodi";
		SODI3 = "/cpus/idle-states/sodi3";
		DPIDLE = "/cpus/idle-states/dpidle";
		SUSPEND = "/cpus/idle-states/suspend";
		reserved_memory = "/reserved-memory";
		consys_mem = "/reserved-memory/consys-reserve-memory";
		wifi_mem = "/reserved-memory/wifi-reserve-memory";
		ssmr_cma_mem = "/reserved-memory/ssmr-reserved-cma_memory";
		cpu_dbgapb = "/cpu_dbgapb@0d410000";
		gic = "/interrupt-controller@0c000000";
		sysirq = "/intpol-controller@10200a80";
		infracfg_ao = "/infracfg_ao@10001000";
		scpsys = "/scpsys@10001000";
		scp_infra = "/scp_infra@10001000";
		topckgen = "/topckgen@10000000";
		dcm = "/dcm@10001000";
		io_cfg_lt = "/io_cfg_lt@10002000";
		io_cfg_lm = "/io_cfg_lm@10002200";
		io_cfg_lb = "/io_cfg_lb@10002400";
		io_cfg_bl = "/io_cfg_bl@10002600";
		io_cfg_rr = "/io_cfg_rr@10002800";
		io_cfg_rb = "/io_cfg_rb@10002a00";
		io_cfg_rt = "/io_cfg_rt@10002c00";
		pericfg = "/pericfg@10003000";
		smart_pa = "/smart_pa";
		tcpc_pd = "/tcpc_pd";
		md1_sim1_hot_plug_eint = "/md1_sim1_hot_plug_eint";
		md1_sim2_hot_plug_eint = "/md1_sim2_hot_plug_eint";
		gpio_usage_mapping = "/gpio";
		gpio = "/gpio@10005000";
		syscfg_pctl_0 = "/syscfg_pctl_0@10005000";
		sleep = "/sleep@10006000";
		eint = "/eint@1000b000";
		pio = "/pinctrl@10005000";
		msdc0_pins_default = "/pinctrl@10005000/msdc0@default";
		msdc0_pins_hs400 = "/pinctrl@10005000/msdc0@hs400";
		msdc0_pins_hs200 = "/pinctrl@10005000/msdc0@hs200";
		msdc0_register_setting_default = "/pinctrl@10005000/msdc0@register_default";
		msdc1_pins_default = "/pinctrl@10005000/msdc1@default";
		msdc1_pins_sdr104 = "/pinctrl@10005000/msdc1@sdr104";
		msdc1_pins_sdr50 = "/pinctrl@10005000/msdc1@sdr50";
		msdc1_pins_ddr50 = "/pinctrl@10005000/msdc1@ddr50";
		msdc1_register_setting_default = "/pinctrl@10005000/msdc1@register_default";
		msdc3_pins_default = "/pinctrl@10005000/msdc3@default";
		msdc3_register_setting_default = "/pinctrl@10005000/msdc3@register_default";
		accdet_pins_default = "/pinctrl@10005000/accdetdefault";
		accdet_pins_eint_as_int = "/pinctrl@10005000/accdeteint@0";
		toprgu = "/toprgu@10007000";
		clk26m = "/clocks/clk26m";
		clk13m = "/clocks/clk13m";
		clk32k = "/clocks/clk32k";
		apmixed = "/apmixed@1000c000";
		fhctl = "/fhctl@1000ce00";
		pwrap = "/pwrap@1000d000";
		main_pmic = "/pwrap@1000d000/main_pmic";
		pmic_accdet = "/pwrap@1000d000/main_pmic/pmic_accdet";
		mt6357keys = "/pwrap@1000d000/main_pmic/mt6357keys";
		pmic_auxadc = "/pwrap@1000d000/main_pmic/pmic_auxadc";
		mtk_gauge = "/pwrap@1000d000/main_pmic/mtk_gauge";
		mtk_charger_type = "/pwrap@1000d000/main_pmic/mtk_charger_type";
		mt6357_charger = "/pwrap@1000d000/main_pmic/mt6357_charger";
		mtk_ts_pmic = "/pwrap@1000d000/main_pmic/mtk_ts_pmic";
		mt6357_ts_buck1 = "/pwrap@1000d000/main_pmic/mt6357_ts_buck1";
		mt6357_ts_buck2 = "/pwrap@1000d000/main_pmic/mt6357_ts_buck2";
		pmic_efuse = "/pwrap@1000d000/main_pmic/pmic_efuse";
		mt6357regulator = "/pwrap@1000d000/main_pmic/mt6357regulator";
		mt_pmic_vs1_buck_reg = "/pwrap@1000d000/main_pmic/mt6357regulator/buck_vs1";
		mt_pmic_vmodem_buck_reg = "/pwrap@1000d000/main_pmic/mt6357regulator/buck_vmodem";
		mt_pmic_vcore_buck_reg = "/pwrap@1000d000/main_pmic/mt6357regulator/buck_vcore";
		mt_pmic_vproc_buck_reg = "/pwrap@1000d000/main_pmic/mt6357regulator/buck_vproc";
		mt_pmic_vpa_buck_reg = "/pwrap@1000d000/main_pmic/mt6357regulator/buck_vpa";
		mt_pmic_vfe28_ldo_reg = "/pwrap@1000d000/main_pmic/mt6357regulator/ldo_vfe28";
		mt_pmic_vxo22_ldo_reg = "/pwrap@1000d000/main_pmic/mt6357regulator/ldo_vxo22";
		mt_pmic_vrf18_ldo_reg = "/pwrap@1000d000/main_pmic/mt6357regulator/ldo_vrf18";
		mt_pmic_vrf12_ldo_reg = "/pwrap@1000d000/main_pmic/mt6357regulator/ldo_vrf12";
		mt_pmic_vefuse_ldo_reg = "/pwrap@1000d000/main_pmic/mt6357regulator/ldo_vefuse";
		mt_pmic_vcn33_bt_ldo_reg = "/pwrap@1000d000/main_pmic/mt6357regulator/ldo_vcn33_bt";
		mt_pmic_vcn33_wifi_ldo_reg = "/pwrap@1000d000/main_pmic/mt6357regulator/ldo_vcn33_wifi";
		mt_pmic_vcn28_ldo_reg = "/pwrap@1000d000/main_pmic/mt6357regulator/ldo_vcn28";
		mt_pmic_vcn18_ldo_reg = "/pwrap@1000d000/main_pmic/mt6357regulator/ldo_vcn18";
		mt_pmic_vcama_ldo_reg = "/pwrap@1000d000/main_pmic/mt6357regulator/ldo_vcama";
		mt_pmic_vcamd_ldo_reg = "/pwrap@1000d000/main_pmic/mt6357regulator/ldo_vcamd";
		mt_pmic_vcamio_ldo_reg = "/pwrap@1000d000/main_pmic/mt6357regulator/ldo_vcamio";
		mt_pmic_vldo28_ldo_reg = "/pwrap@1000d000/main_pmic/mt6357regulator/ldo_vldo28";
		mt_pmic_vsram_others_ldo_reg = "/pwrap@1000d000/main_pmic/mt6357regulator/ldo_vsram_others";
		mt_pmic_vsram_proc_ldo_reg = "/pwrap@1000d000/main_pmic/mt6357regulator/ldo_vsram_proc";
		mt_pmic_vaux18_ldo_reg = "/pwrap@1000d000/main_pmic/mt6357regulator/ldo_vaux18";
		mt_pmic_vaud28_ldo_reg = "/pwrap@1000d000/main_pmic/mt6357regulator/ldo_vaud28";
		mt_pmic_vio28_ldo_reg = "/pwrap@1000d000/main_pmic/mt6357regulator/ldo_vio28";
		mt_pmic_vio18_ldo_reg = "/pwrap@1000d000/main_pmic/mt6357regulator/ldo_vio18";
		mt_pmic_vdram_ldo_reg = "/pwrap@1000d000/main_pmic/mt6357regulator/ldo_vdram";
		mt_pmic_vmc_ldo_reg = "/pwrap@1000d000/main_pmic/mt6357regulator/ldo_vmc";
		mt_pmic_vmch_ldo_reg = "/pwrap@1000d000/main_pmic/mt6357regulator/ldo_vmch";
		mt_pmic_vemc_ldo_reg = "/pwrap@1000d000/main_pmic/mt6357regulator/ldo_vemc";
		mt_pmic_vsim1_ldo_reg = "/pwrap@1000d000/main_pmic/mt6357regulator/ldo_vsim1";
		mt_pmic_vsim2_ldo_reg = "/pwrap@1000d000/main_pmic/mt6357regulator/ldo_vsim2";
		mt_pmic_vibr_ldo_reg = "/pwrap@1000d000/main_pmic/mt6357regulator/ldo_vibr";
		mt_pmic_vusb33_ldo_reg = "/pwrap@1000d000/main_pmic/mt6357regulator/ldo_vusb33";
		mtk_rtc = "/pwrap@1000d000/main_pmic/mtk_rtc";
		fg_init = "/pwrap@1000d000/main_pmic/mtk_rtc/fg_init";
		fg_soc = "/pwrap@1000d000/main_pmic/mtk_rtc/fg_soc";
		ext_32k = "/pwrap@1000d000/main_pmic/mtk_rtc/ext_32k";
		pmic_codec = "/pwrap@1000d000/main_pmic/pmic_codec";
		clock_buffer_ctrl = "/pwrap@1000d000/main_pmic/clock_buffer_ctrl";
		scp = "/scp@10500000";
		keypad = "/kp@10010000";
		mrdump_ext_rst = "/mrdump_ext_rst";
		touch = "/touch";
		accdet_eint = "/accdet_eint";
		accdet = "/accdet";
		irqkey_drv = "/irqkey_drv";
		goodix_fp = "/fingerprint";
		dvfsrc = "/dvfsrc@10012000";
		dvfsrc_freq_opp2 = "/dvfsrc@10012000/opp2";
		dvfsrc_freq_opp1 = "/dvfsrc@10012000/opp1";
		dvfsrc_freq_opp0 = "/dvfsrc@10012000/opp0";
		timer = "/timer@10017000";
		iommu = "/m4u@10205000";
		hwrng = "/hwrng";
		ccifdriver = "/ccifdriver@10209000";
		cldmadriver = "/cldmadriver@10014000";
		mddriver = "/mddriver@10014000";
		md_auxadc = "/md_auxadc";
		gce = "/gce@10238000";
		gce_mbox = "/gce_mbox@10238000";
		auxadc = "/auxadc@11001000";
		apdma = "/dma-controller@11000580";
		uart0 = "/serial@11020000";
		uart1 = "/serial@11030000";
		pwm = "/pwm@11006000";
		i2c_common = "/i2c_common";
		i2c0 = "/i2c0@11007000";
		i2c1 = "/i2c1@11008000";
		i2c2 = "/i2c2@11009000";
		i2c3 = "/i2c3@1100f000";
		i2c4 = "/i2c4@11011000";
		i2c5 = "/i2c5@11016000";
		i2c6 = "/i2c6@1100d000";
		i2c7 = "/i2c7";
		i2c8 = "/i2c8";
		i2c9 = "/i2c9";
		spi0 = "/spi0@1100a000";
		tboard_thermistor1 = "/thermal-sensor1";
		tboard_thermistor2 = "/thermal-sensor2";
		tboard_thermistor3 = "/thermal-sensor3";
		consys = "/consys@18002000";
		wifi = "/wifi@18000000";
		spi1 = "/spi1@11010000";
		spi2 = "/spi2@11012000";
		spi3 = "/spi3@11013000";
		spi4 = "/spi4@11014000";
		spi5 = "/spi5@11015000";
		usb = "/usb0@11200000";
		u2phy0 = "/usb-phy@11210000";
		u2port0 = "/usb-phy@11210000/usb-phy@11210000";
		msdc0 = "/msdc@11230000";
		msdc1 = "/msdc@11240000";
		msdc2 = "/msdc@11250000";
		msdc3 = "/msdc@11260000";
		msdc1_ins = "/msdc1_ins@0";
		audclk = "/audclk@11220000";
		audio = "/audio@11220000";
		audgpio = "/mt_soc_dl1_pcm@11220000";
		btcvsd_snd = "/mtk-btcvsd-snd@18050000";
		mipi_rx_ana_csi0a = "/mipi_rx_ana_csi0a@11c10000";
		mipi_rx_ana_csi0b = "/mipi_rx_ana_csi0b@11c11000";
		mipi_rx_ana_csi1a = "/mipi_rx_ana_csi1a@11c12000";
		mipi_rx_ana_csi1b = "/mipi_rx_ana_csi1b@11c13000";
		mipi_rx_ana_csi2a = "/mipi_rx_ana_csi2a@11c14000";
		mipi_rx_ana_csi2b = "/mipi_rx_ana_csi2b@11c15000";
		efuse = "/efuse@11c50000";
		efuse_segment = "/efuse@11c50000/segment@78";
		cpu_freq_segment = "/efuse@11c50000/segment@1c";
		thermal_efuse = "/efuse@11c50000/segment@190";
		efuse_analog7 = "/efuse@11c50000/efuse_analog7@1ac";
		u2_phy_data = "/efuse@11c50000/u2_phy_data@1ac";
		mfg_clark = "/mfg_clark@13000000";
		mfg_cfg = "/mfg_cfg@13ffe000";
		gpufreq = "/gpufreq";
		ged = "/ged";
		mmsys_config = "/mmsys_config@14000000";
		dispsys_config = "/dispsys_config@14000000";
		nfc = "/nfc";
		irq_nfc = "/irq_nfc";
		disp_mutex0 = "/disp_mutex0@14001000";
		smi_common = "/smi_common@14002000";
		smi_larb0 = "/smi_larb0@14003000";
		mdp_rdma0 = "/mdp_rdma0@14004000";
		mdp_ccorr = "/mdp_ccorr0@14005000";
		mdp_rsz0 = "/mdp_rsz0@14006000";
		mdp_rsz1 = "/mdp_rsz1@14007000";
		mdp_wdma0 = "/mdp_wdma0@14008000";
		mdp_wrot0 = "/mdp_wrot0@14009000";
		mdp_tdshp0 = "/mdp_tdshp0@1400a000";
		disp_color0 = "/disp_color0@1400f000";
		mtkfb = "/mtkfb@0";
		dsi_te = "/dsi_te";
		mm_mutex = "/mm_mutex@14016000";
		camsys = "/camsys@15000000";
		smi_larb2 = "/smi_larb2@15001000";
		kd_camera_hw1 = "/kd_camera_hw1@15040000";
		camera_af_hw_node = "/camera_af_hw_node";
		flashlight_core = "/flashlight_core";
		host_power = "/host_power";
		icnfpsensor = "/icnfpsensor@0";
		flashlights_mt6370 = "/flashlights_mt6370";
		vcodecsys = "/vcodecsys@17000000";
		venc_gcon = "/venc_gcon@17000000";
		smi_larb1 = "/smi_larb1@17010000";
		otg_iddig = "/otg_iddig";
		odm = "/odm";
		memory_ssmr_features = "/memory-ssmr-features";
		lk_charger = "/lk_charger";
		pe = "/pe";
		pe2 = "/pe2";
		pdc = "/pdc";
		pe4 = "/pe4";
		charger = "/charger";
		pd_adapter = "/pd_adapter";
		extcon_usb = "/extcon_usb";
		rt9465_slave_chr = "/rt9465_slave_chr";
		subpmic_pmu_eint = "/mt6370_pmu_eint";
		pmic_clock_buffer_ctrl = "/pmic_clock_buffer_ctrl";
		pbm = "/pbm";
		bat_gm30 = "/battery";
		radio_md_cfg = "/radio_md_cfg";
		dynamic_options = "/dynamic_options";
		cm_mgr = "/cm_mgr@10200000";
		mt6370_pmu = "/mt6370_pmu_dts";
		mt6370_chg = "/mt6370_pmu_dts/charger";
		otg_vbus = "/mt6370_pmu_dts/charger/usb-otg-vbus";
		mt6370_typec = "/type_c_port0";
	};
};
